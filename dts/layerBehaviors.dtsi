magic: magic {
    compatible = "zmk,behavior-hold-tap";
    label = "MAGIC_HOLD_TAP";
    #binding-cells = <2>;
    flavor = "hold-preferred";
    tapping-term-ms = <200>;
    require-prior-idle-ms = <250>;
    bindings = <&mo>, <&rgb_ug_status_macro>;
};

numpad_td: numpad_td {
    compatible = "zmk,behavior-tap-dance";
    #binding-cells = <0>;
    tapping-term-ms = <200>;
    bindings = <&mo LAYER_Num>, <&to LAYER_Num>;
};

/* Tap = number, Hold = shifted symbol (e.g. 1/!, 2/@, 3/#) */
num_ht: num_hold_tap {
    compatible = "zmk,behavior-hold-tap";
    #binding-cells = <2>;
    flavor = "balanced";
    tapping-term-ms = <170>;
    quick-tap-ms = <175>;
    require-prior-idle-ms = <125>;
    bindings = <&kp>, <&kp>;
};