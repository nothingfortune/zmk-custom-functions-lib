/* slicemk — LAYER 6: LeftIndex HRM - SHIFT hold */

        LAYER_LeftIndex {
			bindings = <
			/* Row 0 */
				&none
			/* Row 1 */
				&HRM_left_index_tap_v1B_TKZ EQUAL                              &trans                                &trans                                 &trans                                    &trans                                 &trans                                                                        &mo LAYER_FN                    &mo LAYER_NORM                  &trans                                   &trans                               &trans                                  &trans                                  &trans                                   &trans
			/* Row 2 */
				&trans                        &HRM_left_index_tap_v1B_TKZ Q                           &HRM_left_index_tap_v1B_TKZ W                           &HRM_left_index_tap_v1B_TKZ E                           &HRM_left_index_tap_v1B_TKZ R                           &HRM_left_index_tap_v1B_TKZ T                                                           &kp C_PLAY_PAUSE                &kp C_VOL_UP                    &trans                                       &trans                                &trans                                  &trans                                  &trans                                   &trans
			/* Row 3 */
				&trans                        &HRM_left_index_pinky_v1B_TKZ LGUI A    &HRM_left_index_ring_v1B_TKZ LALT S      &HRM_left_index_middy_v1B_TKZ LCTRL D                 &none                        &HRM_left_index_tap_v1B_TKZ G                                                                   &trans                                   &kp J                                 &kp K                                    &kp L                                   &kp SEMI                                 &trans
			/* Row 4 */
				&trans                        &HRM_left_index_tap_v1B_TKZ Z                           &HRM_left_index_tap_v1B_TKZ X                           &HRM_left_index_tap_v1B_TKZ C                           &HRM_left_index_tap_v1B_TKZ V                           &HRM_left_index_tap_v1B_TKZ B                                                           &kp C_NEXT                      &kp C_VOL_DN                    &trans                                       &trans                                 &trans                                  &trans                                  &trans                                   &trans
			/* Row 5 */
				&kp LCTRL                           &trans                                  &trans                                 &trans                                                                                                                                                       &mkp RCLK                                                                                                                                   &arrow_left LC(LEFT) LEFT                   &trans                                  &trans                                   &trans    &hyper_key

			/* Thumb Cluster - Top Pair */
				&kp DEL                             &trans                     &kp C_NEXT                      &kp DEL
			/* Thumb Cluster - Left to Right*/
				&trans                                    &trans                                 &trans                                                                       &trans                                    &trans                                &trans
			/* Inside Thumb Cluster */
				&lt LAYER_Keypad QUESTION            &lt LAYER_Symbol PERIOD
			>;
		};