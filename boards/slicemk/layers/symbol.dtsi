/* slicemk — LAYER 13: Symbol */

        LAYER_Symbol {
			bindings = <
			/* Row 0 */
				&none
			/* Row 1 */
				&none                                    &none                                  &none                                   &none                                    &none                                    &none                                                                         &mo LAYER_FN                    &mo LAYER_NORM                  &none                                  &none                                 &none                                     &none                                  &none                                    &none
			/* Row 2 */
				&none                                  &kp TILDE                              &kp DOLLAR                                &kp HASH                                &kp CARET                                 &none                                                                         &kp C_PLAY_PAUSE                &kp C_VOL_UP                    &none                                       &kp UNDER                               &kp AT                                 &kp PRCNT                               &kp GRAVE                               &kp COLON
			/* Row 3 */
				&caps_word                              &kp MINUS                               &kp STAR                                &kp PIPE                                &kp AMPS                                   &none                                                                         &none                                &pair_paren                             &kp RPAR                                 &kp PLUS                               &kp EQUAL                                &kp SQT
			/* Row 4 */
				&magic LAYER_Magic 0                           &pair_brace                              &kp RBRC                               &pair_angle                               &kp GT                                    &none                                                                         &kp C_NEXT                      &kp C_VOL_DN                    &none                                       &pair_bracket                             &kp RBKT                                 &kp EXCL                                &kp QMARK                                 &trans
			/* Row 5 */
				&kp LCTRL                           &trans                                &trans                                   &trans                                                                                                                                                                                                &mkp RCLK                                                                                                                                   &arrow_left LC(LEFT) LEFT                   &trans                                  &trans                                  &trans    &hyper_key

			/* Thumb Cluster - Top Pair */
				&kp DEL                             &trans                     &kp C_NEXT                      &kp DEL
			/* Thumb Cluster - Left to Right*/
				&to LAYER_Base                               &trans                                   &trans                                                                      &trans                                   &trans                                  &trans
			/* Inside Thumb Cluster */
				&lt LAYER_Keypad QUESTION            &lt LAYER_Symbol PERIOD
			>;
		};