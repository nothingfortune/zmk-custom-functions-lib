/* slicemk — LAYER 0: Base - QWERTY with Home Row Mods */

        LAYER_Base {
			bindings = <
			/* Row 0 */
				&none
			/* Row 1 */
				&gresc                              &num_ht LS(N1) N1                        &num_ht LS(N2) N2                      &num_ht LS(N3) N3                       &num_ht LS(N4) N4                         &num_ht LS(N5) N5                                                            &mo LAYER_FN                    &mo LAYER_NORM                  &num_ht LS(N6) N6                           &num_ht LS(N7) N7                         &num_ht LS(N8) N8                           &n9_paren                           &num_ht LS(N0) N0                           &pair_brace
			/* Row 2 */
				&tab_hyper LS(LC(LA(LGUI))) TAB                       &kp Q                                  &kp W                                  &kp E                                   &kp R                                 &kp T                                                                          &kp C_PLAY_PAUSE                &kp C_VOL_UP                    &kp Y                                       &kp U                                   &kp I                                   &kp O                                  &kp P                                   &pair_paren
			/* Row 3 */
				&lshft_cw_td                        &HRM_left_pinky_v1B_TKZ LGUI A          &HRM_left_ring_v1B_TKZ LALT S          &HRM_left_middy_v1B_TKZ LCTRL D         &HRM_left_index_v1B_TKZ LSHFT F     &SYM_left_index_v1B_TKZ LAYER_Symbol_lh G                                                                   &SYM_right_index_v1B_TKZ LAYER_Symbol_rh H  &HRM_right_index_v1B_TKZ RSHFT J        &HRM_right_middy_v1B_TKZ RCTRL K         &HRM_right_ring_v1B_TKZ LALT L         &HRM_right_pinky_v1B_TKZ RGUI SEMI                   &dqt_pair
			/* Row 4 */
				&magic LAYER_Magic 0                                &kp Z                                   &kp X                                 &kp C                                    &kp V                                 &kp B                                                                          &kp C_NEXT                      &kp C_VOL_DN                    &kp N                                       &kp M                                &comma_angle                               &kp DOT                               &kp FSLH                                 &numpad_td
			/* Row 5 */
				&kp LCTRL                           &kp LCTRL                                &kp LALT                              &kp LGUI                                                                                                                                              &mkp RCLK                                                                                                                                   &arrow_left LC(LEFT) LEFT                   &arrow_left LA(LEFT) LEFT                   &upDownArrows                     &arrow_right LA(RIGHT) RIGHT    &hyper_key

			/* Thumb Cluster - Top Pair */
				&kp DEL                             &trans                       &kp C_NEXT                      &kp DEL
			/* Thumb Cluster - Left to Right*/
				&thumb_v2_TKZ LAYER_Cursor SPACE        &thumb_v2_TKZ LAYER_Keypad RET              &thumb_v2_TKZ DEL QMARK                                                      &thumb_v2_TKZ DEL PERIOD                         &bspc_word LA(BSPC) BSPC           &thumb_v2_TKZ LAYER_Keypad SPACE
			/* Inside Thumb Cluster */
				&lt LAYER_Keypad QUESTION            &lt LAYER_Symbol PERIOD
			>;
		};