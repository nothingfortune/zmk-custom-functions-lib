/* slicemk — LAYER 1: Typing - Plain ASDF homerow (no HRM)
 * TODO: see boards/go60/layers/typing.dtsi */

        LAYER_Typing {
            bindings = <
                &trans &trans &trans &trans &trans &trans &trans &trans &trans &trans &trans &trans &trans &trans &trans &trans &trans &trans &trans &trans &trans &trans &trans &trans &trans &trans &trans &trans &trans &trans &kp A &kp S &kp D &kp F &trans &trans &kp J &kp K &kp L &kp SEMI &trans &magic LAYER_Magic 0 &trans &trans &trans &trans &trans &trans &trans &trans &trans &trans &trans &trans &trans &trans &trans &trans &trans &trans &trans &trans &trans &trans &trans &trans &trans &trans &trans &trans &trans &trans &trans &trans &trans &trans &trans
            >;
        };
