/* slicemk — LAYER 13: Symbol */

        LAYER_Symbol_lh {
			bindings = <
			/* Row 0 */
				&none
			/* Row 1 */
				&trans                                    &trans                                &trans                                   &trans                                 &trans                                    &trans                                                                      &mo LAYER_FN                    &mo LAYER_NORM                  &trans                                  &trans                                 &trans                                    &trans                                 &trans                                  &trans
			/* Row 2 */
				&trans                                    &trans                                &trans                                   &trans                                 &trans                                    &trans                                                                      &kp C_PLAY_PAUSE                &kp C_VOL_UP                    &trans                                       &kp UNDER                               &kp AT                                  &kp PRCNT                               &kp GRAVE                                &kp COLON
			/* Row 3 */
				&caps_word                                 &trans                                 &trans                                   &trans                                 &trans                                    &kp G                                                                       &trans                                &pair_paren                             &kp RPAR                                  &kp PLUS                               &kp EQUAL                                &kp SQT
			/* Row 4 */
				&magic LAYER_Magic 0                              &trans                                 &trans                                   &trans                                 &trans                                    &trans                                                                      &kp C_NEXT                      &kp C_VOL_DN                    &trans                                       &pair_bracket                             &kp RBKT                                  &kp EXCL                               &kp QMARK                                 &trans
			/* Row 5 */
				&kp LCTRL                           &trans                                 &trans                                   &trans                                                                                                                                                                                               &mkp RCLK                                                                                                                                   &arrow_left LC(LEFT) LEFT                   &trans                                  &trans                                  &trans    &hyper_key

			/* Thumb Cluster - Top Pair */
				&kp DEL                             &trans                     &kp C_NEXT                      &kp DEL
			/* Thumb Cluster - Left to Right*/
				&to LAYER_Base                               &trans                                   &trans                                                                      &trans                                  &trans                                  &trans
			/* Inside Thumb Cluster */
				&lt LAYER_Keypad QUESTION            &lt LAYER_Symbol PERIOD
			>;
		};