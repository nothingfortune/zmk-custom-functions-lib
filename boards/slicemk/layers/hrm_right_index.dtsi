/* slicemk — LAYER 10: RightIndex HRM - SHIFT hold
 * TODO: see boards/go60/layers/hrm_right_index.dtsi */

        LAYER_RightIndex {
            bindings = <
                &trans &trans &trans &trans &trans &trans &trans &trans &trans &trans &trans &trans &trans &trans &trans &trans &trans &trans &trans &trans &trans &trans &trans &HRM_right_index_tap_v1B_TKZ Y &HRM_right_index_tap_v1B_TKZ U &HRM_right_index_tap_v1B_TKZ I &HRM_right_index_tap_v1B_TKZ O &HRM_right_index_tap_v1B_TKZ P &trans &trans &kp A &kp S &kp D &kp F &trans &HRM_right_index_tap_v1B_TKZ H &none &HRM_right_index_middy_v1B_TKZ RCTRL K &HRM_right_index_ring_v1B_TKZ LALT L &HRM_right_index_pinky_v1B_TKZ LGUI SEMI &trans &trans &trans &trans &trans &trans &trans &trans &trans &HRM_right_index_tap_v1B_TKZ N &HRM_right_index_tap_v1B_TKZ M &HRM_right_index_tap_v1B_TKZ COMMA &HRM_right_index_tap_v1B_TKZ DOT &trans &trans &trans &trans &trans &trans &trans &trans &trans &trans &trans &trans &trans &trans &trans &trans &trans &trans &trans &trans &trans &trans &trans &trans
            >;
        };
