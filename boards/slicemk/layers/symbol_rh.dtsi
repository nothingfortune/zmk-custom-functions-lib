/* slicemk — LAYER 13: Symbol */

        LAYER_Symbol_rh {
			bindings = <
			/* Row 0 */
				&none
			/* Row 1 */
				&trans                              &trans               &trans               &trans               &trans              &trans                            &mo LAYER_FN                    &mo LAYER_NORM                  &trans                           &trans                 &trans                 &trans                       &trans                  &trans
			/* Row 2 */
				&trans     &kp TILDE                           &kp DOLLAR                           &kp HASH                           &kp CARET                           &trans                                       &kp C_PLAY_PAUSE                &kp C_VOL_UP                    &trans                                       &trans                             &trans                             &trans                           &trans                              &trans
			/* Row 3 */
				&caps_word                        &kp MINUS  &kp STAR   &kp PIPE &kp AMPS &trans                                                                   &kp H  &trans  &trans  &trans  &trans &trans
			/* Row 4 */
				&magic LAYER_Magic 0                &pair_brace                           &kp RBRC                           &pair_angle                           &kp GT                           &trans                                       &kp C_NEXT                      &kp C_VOL_DN                    &trans                                       &trans                             &trans                      &trans                         &trans                           &trans
			/* Row 5 */
				&kp LCTRL                           &trans                       &trans                        &trans                        &mkp RCLK                                                                                                                                   &arrow_left LC(LEFT) LEFT                   &trans         &trans                     &trans    &hyper_key

			/* Thumb Cluster - Top Pair */
				&kp DEL                             &trans                     &kp C_NEXT                      &kp DEL
			/* Thumb Cluster - Left to Right*/
				&to LAYER_Base    &trans  &trans         &trans                         &trans &trans
			/* Inside Thumb Cluster */
				&lt LAYER_Keypad QUESTION            &lt LAYER_Symbol PERIOD
			>;
		};