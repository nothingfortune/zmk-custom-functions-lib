/* slicemk — LAYER 9: RightMiddy HRM - CTRL hold */

        LAYER_RightMiddy {
			bindings = <
			/* Row 0 */
				&none
			/* Row 1 */
				&trans                              &trans               &trans               &trans               &trans              &trans                            &mo LAYER_FN                    &mo LAYER_NORM                  &trans                           &trans                 &trans                 &trans                       &trans                  &trans
			/* Row 2 */
				&trans     &trans                           &trans                           &trans                           &trans                           &trans                                       &kp C_PLAY_PAUSE                &kp C_VOL_UP                    &HRM_right_middy_tap_v1B_TKZ Y                                       &HRM_right_middy_tap_v1B_TKZ U                             &HRM_right_middy_tap_v1B_TKZ I                             &HRM_right_middy_tap_v1B_TKZ O                           &HRM_right_middy_tap_v1B_TKZ P                              &trans
			/* Row 3 */
				&trans                        &kp A  &kp S   &kp D &kp F &trans                                                                   &HRM_right_middy_tap_v1B_TKZ H  &HRM_right_middy_index_v1B_TKZ RSHFT J  &none  &HRM_right_middy_ring_v1B_TKZ LALT L  &HRM_right_middy_pinky_v1B_TKZ LGUI SEMI &trans
			/* Row 4 */
				&trans                &trans                           &trans                           &trans                           &trans                           &trans                                       &kp C_NEXT                      &kp C_VOL_DN                    &HRM_right_middy_tap_v1B_TKZ N                                       &HRM_right_middy_tap_v1B_TKZ M                             &HRM_right_middy_tap_v1B_TKZ COMMA                      &HRM_right_middy_tap_v1B_TKZ DOT                         &trans                           &trans
			/* Row 5 */
				&kp LCTRL                           &trans                       &trans                        &trans                        &mkp RCLK                                                                                                                                   &arrow_left LC(LEFT) LEFT                   &trans         &trans                     &trans    &hyper_key

			/* Thumb Cluster - Top Pair */
				&kp DEL                             &trans                     &kp C_NEXT                      &kp DEL
			/* Thumb Cluster - Left to Right*/
				&trans    &trans  &trans         &trans                         &trans &trans
			/* Inside Thumb Cluster */
				&lt LAYER_Keypad QUESTION            &lt LAYER_Symbol PERIOD
			>;
		};