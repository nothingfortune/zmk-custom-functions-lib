/* slicemk — LAYER 2: Autoshift */

        LAYER_Autoshift {
			bindings = <
			/* Row 0 */
				&none
			/* Row 1 */
				&AS_v1_TKZ EQUAL                              &trans               &trans               &trans               &trans              &trans                            &mo LAYER_FN                    &mo LAYER_NORM                  &trans                           &trans                 &trans                 &trans                       &trans                  &trans
			/* Row 2 */
				&trans     &AS_v1_TKZ Q                           &AS_v1_TKZ W                           &AS_v1_TKZ E                           &AS_v1_TKZ R                           &AS_v1_TKZ T                                       &kp C_PLAY_PAUSE                &kp C_VOL_UP                    &AS_v1_TKZ Y                                       &AS_v1_TKZ U                             &AS_v1_TKZ I                             &AS_v1_TKZ O                           &AS_v1_TKZ P                              &trans
			/* Row 3 */
				&trans                        &AS_v1_TKZ A  &AS_v1_TKZ S   &AS_v1_TKZ D &AS_v1_TKZ F &AS_v1_TKZ G                                                                   &AS_v1_TKZ H  &AS_v1_TKZ J  &AS_v1_TKZ K  &AS_v1_TKZ L  &AS_v1_TKZ SEMI &trans
			/* Row 4 */
				&magic LAYER_Magic 0                &AS_v1_TKZ Z                           &AS_v1_TKZ X                           &AS_v1_TKZ C                           &AS_v1_TKZ V                           &AS_v1_TKZ B                                       &kp C_NEXT                      &kp C_VOL_DN                    &AS_v1_TKZ N                                       &AS_v1_TKZ M                             &AS_v1_TKZ COMMA                      &AS_v1_TKZ DOT                         &AS_v1_TKZ FSLH                           &trans
			/* Row 5 */
				&kp LCTRL                           &trans                       &trans                        &trans                        &mkp RCLK                                                                                                                                   &arrow_left LC(LEFT) LEFT                   &trans         &trans                     &trans    &hyper_key

			/* Thumb Cluster - Top Pair */
				&kp DEL                             &trans                     &kp C_NEXT                      &kp DEL
			/* Thumb Cluster - Left to Right*/
				&trans    &trans  &trans         &trans                         &trans &trans
			/* Inside Thumb Cluster */
				&lt LAYER_Keypad QUESTION            &lt LAYER_Symbol PERIOD
			>;
		};