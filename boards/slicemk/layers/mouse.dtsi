/* slicemk — LAYER 14: Mouse */

        LAYER_Mouse {
			bindings = <
			/* Row 0 */
				&none
			/* Row 1 */
				&kp ESC                              &mac_mission_ctl               &msc SCRL_UP               &trans               &mkp RCLK              &kp LG(MINUS)                            &mo LAYER_FN                    &mo LAYER_NORM                  &trans                           &trans                 &trans                 &trans                       &mac_mission_ctl                  &mac_app_expose
			/* Row 2 */
				&mac_app_expose     &trans                           &msc SCRL_DOWN                           &mmv MOVE_UP                           &mkp LCLK                           &kp LG(PLUS)                                       &kp C_PLAY_PAUSE                &kp C_VOL_UP                    &trans                                       &trans                             &mmv MOVE_UP                             &trans                           &trans                              &trans
			/* Row 3 */
				&trans                        &msc SCRL_LEFT  &mmv MOVE_LEFT   &mmv MOVE_DOWN &mmv MOVE_RIGHT &msc SCRL_RIGHT                                                                   &trans  &mmv MOVE_LEFT  &mmv MOVE_DOWN  &mmv MOVE_RIGHT  &trans &trans
			/* Row 4 */
				&none                &msc SCRL_DOWN                           &mo LAYER_MouseSlow                           &mo LAYER_MouseFast                           &mo LAYER_MouseWarp                           &kp DEL                                       &kp C_NEXT                      &kp C_VOL_DN                    &trans                                       &mo LAYER_MouseWarp                             &mo LAYER_MouseFast                      &mo LAYER_MouseSlow                         &trans                           &trans
			/* Row 5 */
				&kp LCTRL                           &trans                       &trans                        &trans                        &mkp RCLK                                                                                                                                   &arrow_left LC(LEFT) LEFT                   &trans         &trans                     &trans    &hyper_key

			/* Thumb Cluster - Top Pair */
				&kp DEL                             &trans                     &kp C_NEXT                      &kp DEL
			/* Thumb Cluster - Left to Right*/
				&kp DEL    &trans  &trans         &mkp LCLK                         &trans &trans
			/* Inside Thumb Cluster */
				&lt LAYER_Keypad QUESTION            &lt LAYER_Symbol PERIOD
			>;
		};