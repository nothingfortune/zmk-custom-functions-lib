/* slicemk — LAYER 12: Keypad / Numpad */

        LAYER_Keypad {
			bindings = <
			/* Row 0 */
				&none
			/* Row 1 */
				&kp F1                                     &kp F2                                  &kp F3                                 &kp F4                                   &kp F5                                 &kp F6                                                                        &mo LAYER_FN                    &mo LAYER_NORM                  &kp F7                                &kp F8                                   &kp F9                                &kp F10                                 &kp F11                                 &kp F12
			/* Row 2 */
				&kp TAB                                  &kp STAR                                 &kp N7                                  &kp N8                                  &kp N9                                 &kp SLASH                                                                     &kp C_PLAY_PAUSE                &kp C_VOL_UP                    &kp SLASH                                       &kp N7                                   &kp N8                                &kp N9                                  &kp STAR                                 &trans
			/* Row 3 */
				&none                                    &kp MINUS                               &kp N4                                   &kp N5                                  &kp N6                                 &kp PLUS                                                                     &kp PLUS                               &kp N4                                   &kp N5                                &kp N6                                  &kp PLUS                                 &trans
			/* Row 4 */
				&magic LAYER_Magic 0                             &kp EQUAL                                 &kp N1                                  &kp N2                                  &kp N3                                 &kp MINUS                                                                     &kp C_NEXT                      &kp C_VOL_DN                    &kp MINUS                                       &kp N1                                   &kp N2                                &kp N3                                  &kp ENTER                                  &numpad_td
			/* Row 5 */
				&kp LCTRL                           &kp RET                                  &kp DOT                                  &kp N0                                                                                                                                                      &mkp RCLK                                                                                                                                   &arrow_left LC(LEFT) LEFT                   &kp N0                                  &kp DOT                               &kp RET    &hyper_key

			/* Thumb Cluster - Top Pair */
				&kp DEL                             &trans                     &kp C_NEXT                      &kp DEL
			/* Thumb Cluster - Left to Right*/
				&mo LAYER_Symbol                             &trans                                   &trans                                                                        &trans                                  &trans                                  &trans
			/* Inside Thumb Cluster */
				&lt LAYER_Keypad QUESTION            &lt LAYER_Symbol PERIOD
			>;
		};