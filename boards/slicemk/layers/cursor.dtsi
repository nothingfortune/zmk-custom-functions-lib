/* slicemk — LAYER 11: Cursor / Navigation */

        LAYER_Cursor {
			bindings = <
			/* Row 0 */
				&none
			/* Row 1 */
				&trans               &trans     &none               &trans               &mkp RCLK              &kp LG(PLUS)                            &mo LAYER_FN                    &mo LAYER_NORM                  &msc SCRL_UP                           &trans                 &trans                 &trans                       &trans                  &trans
			/* Row 2 */
				&trans			     &trans     &none                           &mmv MOVE_UP                           &mkp LCLK                           &kp LG(MINUS)                                       &kp C_PLAY_PAUSE                &kp C_VOL_UP                    &msc SCRL_DOWN                                       &trans                             &mmv MOVE_UP                             &trans                           &trans                              &trans
			/* Row 3 */
				&trans               &none  	&mmv MOVE_LEFT   &mmv MOVE_DOWN &mmv MOVE_RIGHT &none                                                                   &trans  &mmv MOVE_LEFT  &mmv MOVE_DOWN  &mmv MOVE_RIGHT  &trans &trans
			/* Row 4 */
				&none                &none      &none                           &mo LAYER_MouseFast                           &mo LAYER_MouseWarp                           &mo LAYER_MouseSlow                                       &kp C_NEXT                      &kp C_VOL_DN                    &mo LAYER_MouseSlow                                       &mo LAYER_MouseFast                             &mo LAYER_MouseWarp                      &none                         &trans                           &trans
			/* Row 5 */
				&kp LCTRL            &trans     &trans                        &trans                        &mkp RCLK                                                                                                                                   &arrow_left LC(LEFT) LEFT                   &trans         &trans                     &trans    &hyper_key

			/* Thumb Cluster - Top Pair */
				&kp DEL                             &trans                     &kp C_NEXT                      &kp DEL
			/* Thumb Cluster - Left to Right*/
				&kp DEL    &mkp RCLK  &mkp LCLK         &mkp LCLK                         &mkp RCLK &trans
			/* Inside Thumb Cluster */
				&lt LAYER_Keypad QUESTION            &lt LAYER_Symbol PERIOD
			>;
		};