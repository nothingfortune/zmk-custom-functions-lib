/* glove80 — LAYER 13: Symbol
 * see boards/go60/layers/symbol.dtsi */

        LAYER_Symbol {
            bindings = <

    /* Left Hand */

/* |-------------------------------------| |-------------------------------------| |-------------------------------------| |-------------------------------------| |-------------------------------------| */
/* │               NONE                  │ │                   F1                │ │                F2                   │ │                 F3                  │ │                  F4                 │ */
                  &none                                      &trans                                &trans                                  &trans                                   &trans
/* |-------------------------------------| |-------------------------------------| |-------------------------------------| |-------------------------------------| |-------------------------------------| |-------------------------------------| */
/* │                ---                  │ │               NONE                  │ │               NONE                  │ │               NONE                  │ │               NONE                  │ │               NONE                  │ */
                  &trans                                     &none                                 &none                                   &none                                    &none                                  &none
/* |-------------------------------------| |-------------------------------------| |-------------------------------------| |-------------------------------------| |-------------------------------------| |-------------------------------------| */
/* │               NONE                  │ │                  ~                  │ │                  $                  │ │                  #                  │ │                  ^                  │ │               NONE                  │ */
                  &none                                   &none                                   &none                                    &none                                    &none                                                                         &none
/* |-------------------------------------| |-------------------------------------| |-------------------------------------| |-------------------------------------| |-------------------------------------| |-------------------------------------| */
/* │             CAPS WORD               │ │                  -                  │ │                  *                  │ │                  |                  │ │                  &                  │ │               NONE                  │ */
                &none                                 &none                                     &none                                  &none                                    &none                                  &none
/* |-------------------------------------| |-------------------------------------| |-------------------------------------| |-------------------------------------| |-------------------------------------| |-------------------------------------| */
/* │               SHIFT                 │ │                  {                  │ │                  }                  │ │                 <>                  │ │                  >                  │ │               NONE                  │ */
                  &kp TILDE                                &kp DOLLAR                                &kp HASH                                &kp CARET                                 &none                                                                         &none
/* |-------------------------------------| |-------------------------------------| |-------------------------------------| |-------------------------------------| |-------------------------------------| |-------------------------------------| */
/* │               MAGIC                 │ │                 LCTRL               │ │                 LALT                │ │                LGUI                 │ │                  ---                │ */
          &kp UNDER                               &kp AT                                 &kp PRCNT                                  &kp GRAVE                                   &kp COLON
/* |-------------------------------------| |-------------------------------------| |-------------------------------------| |-------------------------------------| |-------------------------------------| |-------------------------------------| */

/*                                                                                                                         |-------------------------------------| |-------------------------------------| |-------------------------------------| */
/*                                                                                                                         │             TO BASE                 │ │                  ---               │ │                  ---                │ */
                                                                                                                                      &caps_word                               &kp MINUS                                   &kp STAR
/*                                                                                                                         |-------------------------------------| |-------------------------------------| |-------------------------------------| */
/*                                                                                                                         |-------------------------------------| |-------------------------------------| |-------------------------------------| */
/*                                                                                                                         │             TO BASE                 │ │                  ---               │ │                  ---                │ */
                                                                                                                                      &kp PIPE                                &kp AMPS                                   &none
/*                                                                                                                         |-------------------------------------| |-------------------------------------| |-------------------------------------| */


/* Right Hand */

                                        /* |-------------------------------------| |-------------------------------------| |-------------------------------------| |-------------------------------------| |-------------------------------------| */
                                        /* │                F6                   │ │                   F7                │ │                  F8                 │ │                 F9                  │ │                 F10                 │ */
                                                          &none                                    &pair_paren                                  &kp RPAR                                  &kp PLUS                                  &kp EQUAL
/* |-------------------------------------| |-------------------------------------| |-------------------------------------| |-------------------------------------| |-------------------------------------| |-------------------------------------| */
/* │               NONE                  │ │               NONE                  │ │               NONE                  │ │               NONE                  │ │               NONE                  │ │               NONE                  │ */
                  &kp SQT                                     &magic LAYER_Magic 0                                   &pair_brace                                   &kp RBRC                                  &pair_angle                                    &kp GT
/* |-------------------------------------| |-------------------------------------| |-------------------------------------| |-------------------------------------| |-------------------------------------| |-------------------------------------| */
/* │               NONE                  │ │                  _                  │ │                  @                  │ │                  %                  │ │                  `                  │ │                  :                  │ */
                  &none                                                                         &kp UNDER                               &kp AT                                 &kp PRCNT                               &kp GRAVE                               &kp COLON
/* |-------------------------------------| |-------------------------------------| |-------------------------------------| |-------------------------------------| |-------------------------------------| |-------------------------------------| */
/* │               NONE                  │ │                  ()                 │ │                  )                  │ │                  +                  │ │                  =                  │ │                  '                  │ */
                  &none                                 &none                               &pair_bracket                                 &kp RBKT                                 &kp EXCL                                &kp QMARK
/* |-------------------------------------| |-------------------------------------| |-------------------------------------| |-------------------------------------| |-------------------------------------| |-------------------------------------| */
/* │               NONE                  │ │                  []                 │ │                  ]                  │ │                  !                  │ │                  ?                  │ │                  ---                │ */
                  &trans                               &pair_bracket                              &trans                                 &trans                                   &trans                                                                                                                                                                                                &trans
/* |-------------------------------------| |-------------------------------------| |-------------------------------------| |-------------------------------------| |-------------------------------------| |-------------------------------------| */
                                        /* │               LCTRL                 │ │                  LALT               │ │                 LGUI                │ │                  ---                │ │                   ---               │ */
                                                          &to LAYER_Base                                   &trans                                   &trans                                                                      &trans                                   &trans
                                        /* |-------------------------------------| |-------------------------------------| |-------------------------------------| |-------------------------------------| |-------------------------------------| */

                    /* |-------------------------------------| |-------------------------------------| |-------------------------------------| */
                    /* │                 ---                 │ │                  ---               │ │                  ---                │ */
                        &trans        &trans          &trans
                    /* |-------------------------------------| |-------------------------------------| |-------------------------------------| */
                    /* |-------------------------------------| |-------------------------------------| |-------------------------------------| */
                    /* │                 ---                 │ │                  ---               │ │                  ---                │ */
                           &trans                                  &trans          &trans
                    /* |-------------------------------------| |-------------------------------------| |-------------------------------------| */

            >;
        };
