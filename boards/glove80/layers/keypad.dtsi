/* glove80 — LAYER 12: Keypad / Numpad
 * see boards/go60/layers/keypad.dtsi */

        LAYER_Keypad {
            bindings = <

    /* Left Hand */

/* |-------------------------------------| |-------------------------------------| |-------------------------------------| |-------------------------------------| |-------------------------------------| */
/* │                F1                   │ │                   F1                │ │                F2                   │ │                 F3                  │ │                  F4                 │ */
                  &kp F1                                     &trans                                &trans                                  &trans                                   &trans
/* |-------------------------------------| |-------------------------------------| |-------------------------------------| |-------------------------------------| |-------------------------------------| |-------------------------------------| */
/* │                ---                  │ │                   F2                │ │                F3                   │ │                 F4                  │ │                  F5                 │ │                 F6                  │ */
                  &trans                                     &kp F2                                &kp F3                                  &kp F4                                   &kp F5                                 &kp F1
/* |-------------------------------------| |-------------------------------------| |-------------------------------------| |-------------------------------------| |-------------------------------------| |-------------------------------------| */
/* │               TAB                   │ │                   *                 │ │                  7                  │ │                  8                  │ │                  9                  │ │                  /                  │ */
                  &kp F2                                  &kp F3                               &kp F4                                  &kp F5                                   &kp F6                                 &kp F7
/* |-------------------------------------| |-------------------------------------| |-------------------------------------| |-------------------------------------| |-------------------------------------| |-------------------------------------| */
/* │               NONE                  │ │                   -                 │ │                  4                  │ │                  5                  │ │                  6                  │ │                  +                  │ */
                  &kp F8                                    &kp F9                               &kp F10                                  &kp F11                                   &kp F12                                 &kp TAB
/* |-------------------------------------| |-------------------------------------| |-------------------------------------| |-------------------------------------| |-------------------------------------| |-------------------------------------| */
/* │               SHIFT                 │ │                   =                 │ │                  1                  │ │                  2                  │ │                  3                  │ │                  -                  │ */
                  &kp STAR                                   &kp N7                               &kp N8                                  &kp N9                                   &kp SLASH                                 &kp SLASH
/* |-------------------------------------| |-------------------------------------| |-------------------------------------| |-------------------------------------| |-------------------------------------| |-------------------------------------| */
/* │               MAGIC                 │ │               ENTER                 │ │                  .                  │ │                  0                  │ │                  ---                │ */
          &kp N7                             &kp N8                                &kp N9                                  &kp STAR                                   &trans
/* |-------------------------------------| |-------------------------------------| |-------------------------------------| |-------------------------------------| |-------------------------------------| */

/*                                                                                                                         |-------------------------------------| |-------------------------------------| |-------------------------------------| */
/*                                                                                                                         │          LAYER_Symbol               │ │                  ---               │ │                  ---                │ */
                                                                                                                                     &none                               &kp MINUS                                   &kp N4
/*                                                                                                                         |-------------------------------------| |-------------------------------------| |-------------------------------------| */
/*                                                                                                                         |-------------------------------------| |-------------------------------------| |-------------------------------------| */
/*                                                                                                                         │          LAYER_Symbol               │ │                  ---               │ │                  ---                │ */
                                                                                                                                     &kp N5                               &kp N6                                   &kp PLUS
/*                                                                                                                         |-------------------------------------| |-------------------------------------| |-------------------------------------| */


/* Right Hand */

                                        /* |-------------------------------------| |-------------------------------------| |-------------------------------------| |-------------------------------------| |-------------------------------------| */
                                        /* │                F6                   │ │                   F7                │ │                  F8                 │ │                 F9                  │ │                 F10                 │ */
                                                          &kp PLUS                                    &kp N4                                  &kp N5                                  &kp N6                                  &kp PLUS
/* |-------------------------------------| |-------------------------------------| |-------------------------------------| |-------------------------------------| |-------------------------------------| |-------------------------------------| */
/* │                F7                   │ │                 F8                  │ │                  F9                 │ │                 F10                 │ │                F11                  │ │                 F12                 │ */
                  &trans                                   &magic LAYER_Magic 0                                  &kp EQUAL                                  &kp N1                                &kp N2                                  &kp N3
/* |-------------------------------------| |-------------------------------------| |-------------------------------------| |-------------------------------------| |-------------------------------------| |-------------------------------------| */
/* │                  /                  │ │                  7                  │ │                  8                  │ │                  9                  │ │                  *                  │ │                  ---                │ */
                  &kp MINUS                                &kp N7                                  &kp N8                                  &kp N9                                 &kp STAR                                 &trans
/* |-------------------------------------| |-------------------------------------| |-------------------------------------| |-------------------------------------| |-------------------------------------| |-------------------------------------| */
/* │                  +                  │ │                  4                  │ │                  5                  │ │                  6                  │ │                  +                  │ │                  ---                │ */
                  &kp PLUS                                 &kp MINUS                                  &kp N1                                  &kp N2                                 &kp N3                                 &kp ENTER
/* |-------------------------------------| |-------------------------------------| |-------------------------------------| |-------------------------------------| |-------------------------------------| |-------------------------------------| */
/* │                  -                  │ │                  1                  │ │                  2                  │ │                  3                  │ │               ENTER                 │ │              NUMPAD                 │ */
                  &numpad_td                                &kp N1                                  &kp RET                                  &kp DOT                                 &kp N0                               &numpad_td
/* |-------------------------------------| |-------------------------------------| |-------------------------------------| |-------------------------------------| |-------------------------------------| |-------------------------------------| */
                                        /* │                  0                  │ │                   .                 │ │               RETURN                │ │                  ---                │ │                   ---               │ */
                                                          &mo LAYER_Symbol                                   &trans                                  &trans                                &trans                                   &trans
                                        /* |-------------------------------------| |-------------------------------------| |-------------------------------------| |-------------------------------------| |-------------------------------------| */

                    /* |-------------------------------------| |-------------------------------------| |-------------------------------------| */
                    /* │                 ---                 │ │                  ---               │ │                  ---                │ */
                                        &trans                                  &trans                                   &kp N0
                    /* |-------------------------------------| |-------------------------------------| |-------------------------------------| */
                    /* |-------------------------------------| |-------------------------------------| |-------------------------------------| */
                    /* │                 ---                 │ │                  ---               │ │                  ---                │ */
                                        &kp DOT                                  &kp RET                                   &trans
                    /* |-------------------------------------| |-------------------------------------| |-------------------------------------| */

            >;
        };
