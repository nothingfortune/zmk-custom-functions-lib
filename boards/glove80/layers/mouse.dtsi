/* glove80 — LAYER 14: Mouse
 * see boards/go60/layers/mouse.dtsi */

        LAYER_Mouse {
            bindings = <

    /* Left Hand */

/* |-------------------------------------| |-------------------------------------| |-------------------------------------| |-------------------------------------| |-------------------------------------| */
/* │               ESC                   │ │                   F1                │ │                F2                   │ │                 F3                  │ │                  F4                 │ */
                  &kp ESC                                    &trans                                &trans                                  &trans                                   &trans
/* |-------------------------------------| |-------------------------------------| |-------------------------------------| |-------------------------------------| |-------------------------------------| |-------------------------------------| */
/* │                ---                  │ │         Mission Control             │ │             SCROLL UP               │ │                 ---                 │ │            RIGHT CLICK              │ │              ZOOM OUT               │ */
                  &trans                              &mac_mission_ctl                          &msc SCRL_UP                               &trans                                &mkp RCLK                              &kp ESC
/* |-------------------------------------| |-------------------------------------| |-------------------------------------| |-------------------------------------| |-------------------------------------| |-------------------------------------| */
/* │              Expose                 │ │                 ---                 │ │            SCROLL DOWN              │ │              MOUSE UP               │ │            LEFT CLICK               │ │              ZOOM IN                │ */
            &mac_mission_ctl                                 &msc SCRL_UP                            &trans                           &mkp RCLK                             &kp LG(MINUS)                              &trans
/* |-------------------------------------| |-------------------------------------| |-------------------------------------| |-------------------------------------| |-------------------------------------| |-------------------------------------| */
/* │                ---                  │ │           SCROLL LEFT               │ │            MOUSE LEFT               │ │            MOUSE DOWN               │ │           MOUSE RIGHT               │ │           SCROLL RIGHT              │ */
                  &trans                              &trans                           &trans                          &mac_mission_ctl                         &mac_app_expose                          &mac_app_expose
/* |-------------------------------------| |-------------------------------------| |-------------------------------------| |-------------------------------------| |-------------------------------------| |-------------------------------------| */
/* │                ---                  │ │           SCROLL DOWN               │ │             MOUSESLOW               │ │             MOUSEFAST               │ │             MOUSEWARP               │ │               DEL                   │ */
                  &trans                               &msc SCRL_DOWN                       &mmv MOVE_UP                      &mkp LCLK                     &kp LG(PLUS)                           &trans
/* |-------------------------------------| |-------------------------------------| |-------------------------------------| |-------------------------------------| |-------------------------------------| |-------------------------------------| */
/* │                ---                  │ │                 LCTRL               │ │                 LALT                │ │                LGUI                 │ │                  ---                │ */
                  &trans                                     &mmv MOVE_UP                                 &trans                                &trans                                   &trans 
/* |-------------------------------------| |-------------------------------------| |-------------------------------------| |-------------------------------------| |-------------------------------------| */

/*                                                                                                                         |-------------------------------------| |-------------------------------------| |-------------------------------------| */
/*                                                                                                                         │               DEL                   │ │                  ---                │ │                  ---                │ */
                                                                                                                                          &trans                                   &msc SCRL_LEFT                                   &mmv MOVE_LEFT
/*                                                                                                                         |-------------------------------------| |-------------------------------------| |-------------------------------------| */
/*                                                                                                                         |-------------------------------------| |-------------------------------------| |-------------------------------------| */
/*                                                                                                                         │               DEL                   │ │                  ---                │ │                  ---                │ */
                                                                                                                                         &mmv MOVE_DOWN                                     &mmv MOVE_RIGHT                                   &msc SCRL_RIGHT
/*                                                                                                                         |-------------------------------------| |-------------------------------------| |-------------------------------------| */


/* Right Hand */

                                        /* |-------------------------------------| |-------------------------------------| |-------------------------------------| |-------------------------------------| |-------------------------------------| */
                                        /* │                F6                   │ │                   F7                │ │                  F8                 │ │                 F9                  │ │                 F10                 │ */
                                                          &trans                                    &mmv MOVE_LEFT                                  &mmv MOVE_DOWN                                  &mmv MOVE_RIGHT                                  &trans
/* |-------------------------------------| |-------------------------------------| |-------------------------------------| |-------------------------------------| |-------------------------------------| |-------------------------------------| */
/* │                ---                  │ │                 ---                 │ │                 ---                 │ │                 ---                 │ │         Mission Control             │ │            App Exposè               │ */
                  &trans                                    &none                                  &msc SCRL_DOWN                                  &mo LAYER_MouseSlow                             &mo LAYER_MouseFast                         &mo LAYER_MouseWarp
/* |-------------------------------------| |-------------------------------------| |-------------------------------------| |-------------------------------------| |-------------------------------------| |-------------------------------------| */
/* │                ---                  │ │                 ---                 │ │              MOVE UP                │ │                 ---                 │ │                ---                  │ │                  ---                │ */
                  &kp DEL                                    &trans                              &mmv MOVE_UP                                &trans                                 &trans                                   &trans
/* |-------------------------------------| |-------------------------------------| |-------------------------------------| |-------------------------------------| |-------------------------------------| |-------------------------------------| */
/* │                ---                  │ │            MOVE LEFT                │ │             MOVE DOWN               │ │            MOVE RIGHT               │ │                ---                  │ │                  ---                │ */
                  &trans                               &trans                          &mo LAYER_MouseWarp                          &mo LAYER_MouseFast                            &mo LAYER_MouseSlow                                   &trans
/* |-------------------------------------| |-------------------------------------| |-------------------------------------| |-------------------------------------| |-------------------------------------| |-------------------------------------| */
/* │                ---                  │ │             MOUSEWARP               │ │             MOUSEFAST               │ │             MOUSESLOW               │ │                ---                  │ │                  ---                │ */
                  &trans                           &mo LAYER_MouseWarp                      &trans                    &trans                            &trans                                   &trans
/* |-------------------------------------| |-------------------------------------| |-------------------------------------| |-------------------------------------| |-------------------------------------| |-------------------------------------| */
                                        /* │               LCTRL                 │ │                  LALT               │ │                 LGUI                │ │                  ---                │ │                   ---               │ */
                                                          &kp DEL                                   &trans                                   &trans                                 &mkp LCLK                                   &trans
                                        /* |-------------------------------------| |-------------------------------------| |-------------------------------------| |-------------------------------------| |-------------------------------------| */

                    /* |-------------------------------------| |-------------------------------------| |-------------------------------------| */
                    /* │            LEFT MOUSE               │ │                 ---                 │ │                 ---                 │ */
                                    &trans                                   &trans                                  &trans
                    /* |-------------------------------------| |-------------------------------------| |-------------------------------------| */
                    /* |-------------------------------------| |-------------------------------------| |-------------------------------------| */
                    /* │            LEFT MOUSE               │ │                 ---                 │ │                 ---                 │ */
                                    &trans                                   &trans                                  &trans
                    /* |-------------------------------------| |-------------------------------------| |-------------------------------------| */

            >;
        };
