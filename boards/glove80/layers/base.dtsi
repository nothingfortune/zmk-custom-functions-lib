/* glove80 — LAYER 0: Base - QWERTY with Home Row Mods
 * TODO: see boards/go60/layers/base.dtsi */

        LAYER_Base {
            bindings = <
    
    /* Left Hand */

/* |-------------------------------------| |-------------------------------------| |-------------------------------------| |-------------------------------------| |-------------------------------------| */
/* │                ESC/`                │ │                   F1                │ │                  F2                 │ │                 F3                  │ │                  F4                 │ */
                  &gresc                                     &trans                                &trans                                  &trans                                   &trans                  
/* |-------------------------------------| |-------------------------------------| |-------------------------------------| |-------------------------------------| |-------------------------------------| |-------------------------------------| */ 
/* │               EQUAL                 │ │                   1/!               │ │                   2/@               │ │                 3/#                 │ │                  4/$                │ │                  5/%                │ */
                 &kp EQUAL                             &num_ht LS(N1) N1                        &num_ht LS(N2) N2                      &num_ht LS(N3) N3                       &num_ht LS(N4) N4                         &gresc            
/* |-------------------------------------| |-------------------------------------| |-------------------------------------| |-------------------------------------| |-------------------------------------| |-------------------------------------| */ 
/* │                TAB                  │ │                    Q                │ │                   W                 │ │                   E                 │ │                   R                 │ │                 T                   │ */
                 &num_ht LS(N1) N1                        &num_ht LS(N2) N2                                  &num_ht LS(N3) N3                                   &num_ht LS(N4) N4                                   &num_ht LS(N5) N5                                                            &num_ht LS(N6) N6                   
/* |-------------------------------------| |-------------------------------------| |-------------------------------------| |-------------------------------------| |-------------------------------------| |-------------------------------------| */
/* │         Lshift + 2xCAPSLCK          │ │            GUI(hold)/A              │ │             ALT(hold)/S             │ │             CTRL(hold)/D            │ │            SHIFT(hold)/F            │ │            SYMB(hold)/G             │ */
                &num_ht LS(N7) N7                         &num_ht LS(N8) N8                           &n9_paren                           &num_ht LS(N0) N0                           &pair_brace             &tab_hyper LS(LC(LA(LGUI))) TAB     
/* |-------------------------------------| |-------------------------------------| |-------------------------------------| |-------------------------------------| |-------------------------------------| |-------------------------------------| */
/* │               SHIFT                 │ │                    Z                │ │                    X                │ │                  C                  │ │                   V                 │ │                 B                   │ */
                &kp Q                                    &kp W                                   &kp E                                   &kp R                                    &kp T                                                                          &kp Y                   
/* |-------------------------------------| |-------------------------------------| |-------------------------------------| |-------------------------------------| |-------------------------------------| |-------------------------------------| */
/* │               MAGIC                 │ │                    Z                │ │                    X                │ │                  C                  │ │                   V                 │ */
          &kp U                                   &kp I                                   &kp O                                  &kp P                                   &pair_paren                         
/* |-------------------------------------| |-------------------------------------| |-------------------------------------| |-------------------------------------| |-------------------------------------| */

/*                                                                                                                         |-------------------------------------| |-------------------------------------| |-------------------------------------| */
/*                                                                                                                         │           NAV(hold)/SPACE           │ │                ENTER                │ │             NUMPAD(hold)/?          │ */
                                                                                                                               &lshft_cw_td                     &HRM_left_pinky_v1B_TKZ LGUI A          &HRM_left_ring_v1B_TKZ LALT S    
/*                                                                                                                         |-------------------------------------| |-------------------------------------| |-------------------------------------| */
/*                                                                                                                         |-------------------------------------| |-------------------------------------| |-------------------------------------| */
/*                                                                                                                         │           NAV(hold)/SPACE           │ │                ENTER                │ │             NUMPAD(hold)/?          │ */
                                                                                                                               &HRM_left_middy_v1B_TKZ LCTRL D         &HRM_left_index_v1B_TKZ LSHFT F          &SYM_left_index_v1B_TKZ LAYER_Symbol_lh G    
/*                                                                                                                         |-------------------------------------| |-------------------------------------| |-------------------------------------| */
    
    
/* Right Hand */

                                        /* |-------------------------------------| |-------------------------------------| |-------------------------------------| |-------------------------------------| |-------------------------------------| */
                                        /* │                F6                   │ │                   F7                │ │                  F8                 │ │                 F9                  │ │                  F10                │ */
                                                          &SYM_right_index_v1B_TKZ LAYER_Symbol_rh H                                     &HRM_right_index_v1B_TKZ RSHFT J                                &HRM_right_middy_v1B_TKZ RCTRL K                                  &HRM_right_ring_v1B_TKZ LALT L                                   &HRM_right_pinky_v1B_TKZ RGUI SEMI                  
/* |-------------------------------------| |-------------------------------------| |-------------------------------------| |-------------------------------------| |-------------------------------------| |-------------------------------------| */ 
/* │                 6                   │ │                 7                   │ │                   8                 │ │                  9                  │ │                 0                   │ │                  -                  │ */
            &dqt_pair                         &magic LAYER_Magic 0                                &kp Z                                   &kp X                                 &kp C                                    &kp V            
/* |-------------------------------------| |-------------------------------------| |-------------------------------------| |-------------------------------------| |-------------------------------------| |-------------------------------------| */ 
/* │                 Y                   │ │                  U                  │ │                  I                  │ │                   O                 │ │                 P                   │ │                  ()                 │ */
                 &kp B                                                                          &kp U                                     &kp I                                   &kp O                                 &kp P                                  &pair_paren                   
/* |-------------------------------------| |-------------------------------------| |-------------------------------------| |-------------------------------------| |-------------------------------------| |-------------------------------------| */
/* │            SYMB(hold)/H             │ │           SHIFT(hold)/J             │ │             CTRL(hold)/K            │ │             ALT(hold)/L             │ │             GUI(hold)/;             │ │                  ""                 │ */
         &lt_v2_TKZ LAYER_Symbol H           &kp N                                  &kp M                                &comma_angle                               &kp DOT                               &kp FSLH                                            
/* |-------------------------------------| |-------------------------------------| |-------------------------------------| |-------------------------------------| |-------------------------------------| |-------------------------------------| */
/* │                 N                   │ │                  M                  │ │                 ,/<>                │ │                  .                  │ │                  /                  │ │                   B                 │ */
                   &numpad_td                                    &kp M                                &kp LCTRL                                &kp LALT                                &kp LGUI                                                                                                                                              &kp B                   
/* |-------------------------------------| |-------------------------------------| |-------------------------------------| |-------------------------------------| |-------------------------------------| |-------------------------------------| */
                                        /* │                MAGIC                │ │                   Z                 │ │                  X                  │ │                  C                  │ │                   V                 │ */
                                                           &thumb_v2_TKZ LAYER_Cursor SPACE                                &thumb_v2_TKZ LAYER_Keypad RET                              &thumb_v2_TKZ DEL QMARK                                                      &thumb_v2_TKZ DEL PERIOD                                   &bspc_word LA(BSPC) BSPC
                                        /* |-------------------------------------| |-------------------------------------| |-------------------------------------| |-------------------------------------| |-------------------------------------| */

/* |-------------------------------------| |-------------------------------------| |-------------------------------------| */
/* │           NAV(hold)/SPACE           │ │                ENTER                │ │             NUMPAD(hold)/?          │ */
        &thumb_v2_TKZ LAYER_Keypad SPACE        &thumb_v2_TKZ LAYER_Symbol RET          &arrow_left LA(LEFT) LEFT    
/* |-------------------------------------| |-------------------------------------| |-------------------------------------| */
/* |-------------------------------------| |-------------------------------------| |-------------------------------------| */
/* │           NAV(hold)/SPACE           │ │                ENTER                │ │             NUMPAD(hold)/?          │ */
       &upDownArrows                     &arrow_right LA(RIGHT) RIGHT          &thumb_v2_TKZ LAYER_Keypad QMARK    
/* |-------------------------------------| |-------------------------------------| |-------------------------------------| */

            >;
        };