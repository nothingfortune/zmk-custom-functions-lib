/* glove80 — LAYER 3: LeftPinky HRM - GUI hold
 * see boards/go60/layers/hrm_left_pinky.dtsi */

        LAYER_LeftPinky {
            bindings = <

    /* Left Hand */

/* |-------------------------------------| |-------------------------------------| |-------------------------------------| |-------------------------------------| |-------------------------------------| */
/* │             ESC/`(HRM)              │ │                   F1                │ │                F2                   │ │                 F3                  │ │                  F4                 │ */
      &HRM_left_pinky_tap_v1B_TKZ EQUAL                    &trans                                &trans                                  &trans                                   &trans
/* |-------------------------------------| |-------------------------------------| |-------------------------------------| |-------------------------------------| |-------------------------------------| |-------------------------------------| */
/* │              EQUAL                  │ │                   1/!               │ │                2/@                  │ │                 3/#                 │ │                  4/$                │ │                5/%                  │ */
                  &trans                                     &trans                                &trans                                  &trans                                   &trans                                 &HRM_left_pinky_tap_v1B_TKZ EQUAL
/* |-------------------------------------| |-------------------------------------| |-------------------------------------| |-------------------------------------| |-------------------------------------| |-------------------------------------| */
/* │               TAB                   │ │                  Q(HRM)             │ │               W(HRM)                │ │               E(HRM)                │ │               R(HRM)                │ │               T(HRM)                │ */
                  &trans                      &trans          &trans          &trans          &trans          &trans
/* |-------------------------------------| |-------------------------------------| |-------------------------------------| |-------------------------------------| |-------------------------------------| |-------------------------------------| */
/* │                ---                  │ │                  ---                │ │           ALT(hold)/S               │ │           CTRL(hold)/D              │ │           SHIFT(hold)/F             │ │               G(HRM)                │ */
                  &trans                                     &trans                    &trans    &trans   &trans          &trans
/* |-------------------------------------| |-------------------------------------| |-------------------------------------| |-------------------------------------| |-------------------------------------| |-------------------------------------| */
/* │               SHIFT                 │ │                  Z(HRM)             │ │               X(HRM)                │ │               C(HRM)                │ │               V(HRM)                │ │               B(HRM)                │ */
                  &HRM_left_pinky_tap_v1B_TKZ Q                      &HRM_left_pinky_tap_v1B_TKZ W          &HRM_left_pinky_tap_v1B_TKZ E          &HRM_left_pinky_tap_v1B_TKZ R          &HRM_left_pinky_tap_v1B_TKZ T          &trans
/* |-------------------------------------| |-------------------------------------| |-------------------------------------| |-------------------------------------| |-------------------------------------| |-------------------------------------| */
/* │                ---                  │ │                 LCTRL               │ │                 LALT                │ │                LGUI                 │ │                  ---                │ */
                  &trans                                     &trans                                 &trans                                  &trans                                   &trans
/* |-------------------------------------| |-------------------------------------| |-------------------------------------| |-------------------------------------| |-------------------------------------| */

/*                                                                                                                         |-------------------------------------| |-------------------------------------| |-------------------------------------| */
/*                                                                                                                         │                 ---                 │ │                  ---                │ │                  ---                │ */
                                                                                                                                           &trans                                  &none                                   &HRM_left_pinky_ring_v1B_TKZ LALT S
/*                                                                                                                         |-------------------------------------| |-------------------------------------| |-------------------------------------| */
/*                                                                                                                         |-------------------------------------| |-------------------------------------| |-------------------------------------| */
/*                                                                                                                         │                 ---                 │ │                  ---                │ │                  ---                │ */
                                                                                                                                           &HRM_left_pinky_middy_v1B_TKZ LCTRL D                                  &HRM_left_pinky_index_v1B_TKZ LSHFT F                                   &HRM_left_pinky_tap_v1B_TKZ G
/*                                                                                                                         |-------------------------------------| |-------------------------------------| |-------------------------------------| */


/* Right Hand */

                                        /* |-------------------------------------| |-------------------------------------| |-------------------------------------| |-------------------------------------| |-------------------------------------| */
                                        /* │                F6                   │ │                   F7                │ │                  F8                 │ │                 F9                  │ │                 F10                 │ */
                                                          &trans                                    &kp J                                  &kp K                                  &kp K                                  &kp SEMI
/* |-------------------------------------| |-------------------------------------| |-------------------------------------| |-------------------------------------| |-------------------------------------| |-------------------------------------| */
/* │                 6                   │ │                 7                   │ │                   8                 │ │                  9                  │ │                 0                   │ │                  -                  │ */
                  &trans                                    &trans                                  &HRM_left_pinky_tap_v1B_TKZ Z                                  &HRM_left_pinky_tap_v1B_TKZ X                                 &HRM_left_pinky_tap_v1B_TKZ C                                   &HRM_left_pinky_tap_v1B_TKZ V
/* |-------------------------------------| |-------------------------------------| |-------------------------------------| |-------------------------------------| |-------------------------------------| |-------------------------------------| */
/* │                 Y                   │ │                  U                  │ │                  I                  │ │                   O                 │ │                 P                   │ │                  ()                 │ */
                  &HRM_left_pinky_tap_v1B_TKZ B                                    &trans                                  &trans                                  &trans                                 &trans                                   &trans
/* |-------------------------------------| |-------------------------------------| |-------------------------------------| |-------------------------------------| |-------------------------------------| |-------------------------------------| */
/* │                ---                  │ │                  J                  │ │                  K                  │ │                  K                  │ │                SEMI                 │ │                  ---                │ */
                  &trans                                    &trans                                   &trans                                   &trans                                  &trans                                 &trans
/* |-------------------------------------| |-------------------------------------| |-------------------------------------| |-------------------------------------| |-------------------------------------| |-------------------------------------| */
/* │                N                    │ │                  M                  │ │                 ,                   │ │                  .                  │ │                  /                  │ │                   ---               │ */
                  &trans                                   &trans                                   &trans                                  &trans                                 &trans                                   &trans
/* |-------------------------------------| |-------------------------------------| |-------------------------------------| |-------------------------------------| |-------------------------------------| |-------------------------------------| */
                                        /* │               LCTRL                 │ │                  LALT               │ │                 LGUI                │ │                  ---                │ │                   ---               │ */
                                                          &trans                                   &trans                                   &trans                                 &trans                                   &trans
                                        /* |-------------------------------------| |-------------------------------------| |-------------------------------------| |-------------------------------------| |-------------------------------------| */

                    /* |-------------------------------------| |-------------------------------------| |-------------------------------------| */
                    /* │                 ---                 │ │                  ---                │ │                  ---                │ */
                                        &trans                                  &trans                                   &trans
                    /* |-------------------------------------| |-------------------------------------| |-------------------------------------| */
                    /* |-------------------------------------| |-------------------------------------| |-------------------------------------| */
                    /* │                 ---                 │ │                  ---                │ │                  ---                │ */
                                        &trans                                  &trans                                   &trans
                    /* |-------------------------------------| |-------------------------------------| |-------------------------------------| */

            >;
        };
