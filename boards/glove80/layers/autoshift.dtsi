/* glove80 — LAYER 2: Autoshift
 * see boards/go60/layers/autoshift.dtsi */

        LAYER_Autoshift {
            bindings = <

    /* Left Hand */

/* |-------------------------------------| |-------------------------------------| |-------------------------------------| |-------------------------------------| |-------------------------------------| */
/* │              ESC/`(AS)              │ │                   F1                │ │                F2                   │ │                 F3                  │ │                  F4                 │ */
             &AS_v1_TKZ EQUAL                              &trans                                &trans                                  &trans                                   &trans
/* |-------------------------------------| |-------------------------------------| |-------------------------------------| |-------------------------------------| |-------------------------------------| |-------------------------------------| */
/* │              EQUAL                  │ │                   1/!               │ │                2/@                  │ │                 3/#                 │ │                  4/$                │ │                5/%                  │ */
                  &trans                                     &trans                                &trans                                  &trans                                   &trans                                 &AS_v1_TKZ EQUAL
/* |-------------------------------------| |-------------------------------------| |-------------------------------------| |-------------------------------------| |-------------------------------------| |-------------------------------------| */
/* │               TAB                   │ │                  Q(AS)              │ │                W(AS)                │ │                E(AS)                │ │                R(AS)                │ │                T(AS)                │ */
                  &trans                                   &trans                                 &trans                                   &trans                                  &trans                                                                       &trans
/* |-------------------------------------| |-------------------------------------| |-------------------------------------| |-------------------------------------| |-------------------------------------| |-------------------------------------| */
/* │                ---                  │ │                  A(AS)              │ │                S(AS)                │ │                D(AS)                │ │                F(AS)                │ │                G(AS)                │ */
                  &trans                                 &trans                                 &trans                                  &trans                                   &trans                           &trans
/* |-------------------------------------| |-------------------------------------| |-------------------------------------| |-------------------------------------| |-------------------------------------| |-------------------------------------| */
/* │               SHIFT                 │ │                  Z(AS)              │ │                X(AS)                │ │                C(AS)                │ │                V(AS)                │ │                B(AS)                │ */
                  &AS_v1_TKZ Q                                 &AS_v1_TKZ W                           &AS_v1_TKZ E                              &AS_v1_TKZ R                             &AS_v1_TKZ T                                                                  &AS_v1_TKZ Y
/* |-------------------------------------| |-------------------------------------| |-------------------------------------| |-------------------------------------| |-------------------------------------| |-------------------------------------| */
/* │               MAGIC                 │ │                 LCTRL               │ │                 LALT                │ │                LGUI                 │ │                  ---                │ */
          &AS_v1_TKZ U                              &AS_v1_TKZ I                                 &AS_v1_TKZ O                                  &AS_v1_TKZ P                                   &trans
/* |-------------------------------------| |-------------------------------------| |-------------------------------------| |-------------------------------------| |-------------------------------------| */

/*                                                                                                                         |-------------------------------------| |-------------------------------------| |-------------------------------------| */
/*                                                                                                                         │                 ---                 │ │                  ---               │ │                  ---                │ */
                                                                                                                                           &trans                                  &AS_v1_TKZ A                                   &AS_v1_TKZ S
/*                                                                                                                         |-------------------------------------| |-------------------------------------| |-------------------------------------| */
/*                                                                                                                         |-------------------------------------| |-------------------------------------| |-------------------------------------| */
/*                                                                                                                         │                 ---                 │ │                  ---               │ │                  ---                │ */
                                                                                                                                           &AS_v1_TKZ D                                  &AS_v1_TKZ F                                   &AS_v1_TKZ G
/*                                                                                                                         |-------------------------------------| |-------------------------------------| |-------------------------------------| */


/* Right Hand */

                                        /* |-------------------------------------| |-------------------------------------| |-------------------------------------| |-------------------------------------| |-------------------------------------| */
                                        /* │                F6                   │ │                   F7                │ │                  F8                 │ │                 F9                  │ │                 F10                 │ */
                                                          &AS_v1_TKZ H                                    &AS_v1_TKZ J                                  &AS_v1_TKZ K                                  &AS_v1_TKZ L                                  &AS_v1_TKZ SEMI
/* |-------------------------------------| |-------------------------------------| |-------------------------------------| |-------------------------------------| |-------------------------------------| |-------------------------------------| */
/* │                 6                   │ │                 7                   │ │                   8                 │ │                  9                  │ │                 0                   │ │                  -                  │ */
                  &trans                                    &magic LAYER_Magic 0                                  &AS_v1_TKZ Z                                  &AS_v1_TKZ X                                 &AS_v1_TKZ C                                   &AS_v1_TKZ V
/* |-------------------------------------| |-------------------------------------| |-------------------------------------| |-------------------------------------| |-------------------------------------| |-------------------------------------| */
/* │                Y(AS)                │ │                U(AS)                │ │                I(AS)                │ │                O(AS)                │ │                P(AS)                │ │                  ()                 │ */
             &AS_v1_TKZ B                                                                  &AS_v1_TKZ U                            &AS_v1_TKZ I                            &AS_v1_TKZ O                           &AS_v1_TKZ P                                 &trans
/* |-------------------------------------| |-------------------------------------| |-------------------------------------| |-------------------------------------| |-------------------------------------| |-------------------------------------| */
/* │                H(AS)                │ │                J(AS)                │ │                K(AS)                │ │                L(AS)                │ │               ;(AS)                 │ │                  ---                │ */
             &AS_v1_TKZ H                              &AS_v1_TKZ N                            &AS_v1_TKZ M                            &AS_v1_TKZ COMMA                          &AS_v1_TKZ DOT                               &AS_v1_TKZ FSLH
/* |-------------------------------------| |-------------------------------------| |-------------------------------------| |-------------------------------------| |-------------------------------------| |-------------------------------------| */
/* │                N(AS)                │ │                M(AS)                │ │              ,(AS)                  │ │                .(AS)                │ │               /(AS)                 │ │                   ---               │ */
             &trans                              &AS_v1_TKZ M                          &trans                                  &trans                              &trans                                                                                                                                                                                                    &trans
/* |-------------------------------------| |-------------------------------------| |-------------------------------------| |-------------------------------------| |-------------------------------------| |-------------------------------------| */
                                        /* │               LCTRL                 │ │                  LALT               │ │                 LGUI                │ │                  ---                │ │                   ---               │ */
                                                          &trans                                     &trans                                   &trans                                                                        &trans                                   &trans
                                        /* |-------------------------------------| |-------------------------------------| |-------------------------------------| |-------------------------------------| |-------------------------------------| */

                    /* |-------------------------------------| |-------------------------------------| |-------------------------------------| */
                    /* │                 ---                 │ │                  ---               │ │                  ---                │ */
                        &trans        &trans          &trans
                    /* |-------------------------------------| |-------------------------------------| |-------------------------------------| */
                    /* |-------------------------------------| |-------------------------------------| |-------------------------------------| */
                    /* │                 ---                 │ │                  ---               │ │                  ---                │ */
                           &trans                                   &trans          &trans
                    /* |-------------------------------------| |-------------------------------------| |-------------------------------------| */
            >;
        };
