/* glove80 — LAYER 5: LeftMiddy HRM - CTRL hold
 * see boards/go60/layers/hrm_left_middy.dtsi */

        LAYER_LeftMiddy {
            bindings = <

    /* Left Hand */

/* |-------------------------------------| |-------------------------------------| |-------------------------------------| |-------------------------------------| |-------------------------------------| */
/* │             ESC/`(HRM)              │ │                 F1                  │ │                F2                   │ │                 F3                  │ │                  F4                 │ */
      &HRM_left_middy_tap_v1B_TKZ EQUAL                     &trans                                 &trans                                   &trans                                   &trans
/* |-------------------------------------| |-------------------------------------| |-------------------------------------| |-------------------------------------| |-------------------------------------| |-------------------------------------| */
/* │              EQUAL                  │ │                 1/!                 │ │                2/@                  │ │                 3/#                 │ │                  4/$                │ │                5/%                  │ */
                  &trans                                     &trans                                &trans                                  &trans                                   &trans                                 &HRM_left_middy_tap_v1B_TKZ EQUAL
/* |-------------------------------------| |-------------------------------------| |-------------------------------------| |-------------------------------------| |-------------------------------------| |-------------------------------------| */
/* │               TAB                   │ │                 Q(HRM)              │ │               W(HRM)                │ │               E(HRM)                │ │               R(HRM)                │ │               T(HRM)                │ */
                  &trans                                     &trans                                 &trans                                    &trans                                 &trans                                                                       &trans
/* |-------------------------------------| |-------------------------------------| |-------------------------------------| |-------------------------------------| |-------------------------------------| |-------------------------------------| */
/* │                ---                  │ │           GUI(hold)/A               │ │           ALT(hold)/S               │ │                  ---                │ │           SHIFT(hold)/F             │ │               G(HRM)                │ */
                  &trans                                     &trans                                  &trans                                  &trans                                   &trans         &trans
/* |-------------------------------------| |-------------------------------------| |-------------------------------------| |-------------------------------------| |-------------------------------------| |-------------------------------------| */
/* │               SHIFT                 │ │                  Z(HRM)             │ │               X(HRM)                │ │               C(HRM)                │ │               V(HRM)                │ │               B(HRM)                │ */
         &HRM_left_middy_tap_v1B_TKZ Q           &HRM_left_middy_tap_v1B_TKZ W           &HRM_left_middy_tap_v1B_TKZ E           &HRM_left_middy_tap_v1B_TKZ R           &HRM_left_middy_tap_v1B_TKZ T                                                           &trans
/* |-------------------------------------| |-------------------------------------| |-------------------------------------| |-------------------------------------| |-------------------------------------| |-------------------------------------| */
/* │                ---                  │ │                 LCTRL               │ │                 LALT                │ │                LGUI                 │ │                  ---                │ */
                  &trans                                     &trans                                  &trans                                  &trans                                   &trans
/* |-------------------------------------| |-------------------------------------| |-------------------------------------| |-------------------------------------| |-------------------------------------| */

/*                                                                                                                         |-------------------------------------| |-------------------------------------| |-------------------------------------| */
/*                                                                                                                         │                 ---                 │ │                  ---                │ │                  ---                │ */
                                                                                                                                           &trans                                  &HRM_left_middy_pinky_v1B_TKZ LGUI A                                   &HRM_left_middy_ring_v1B_TKZ LALT S
/*                                                                                                                         |-------------------------------------| |-------------------------------------| |-------------------------------------| */
/*                                                                                                                         |-------------------------------------| |-------------------------------------| |-------------------------------------| */
/*                                                                                                                         │                 ---                 │ │                  ---                │ │                  ---                │ */
                                                                                                                                           &none                                  &HRM_left_middy_index_v1B_TKZ LSHFT F                                   &HRM_left_middy_tap_v1B_TKZ G
/*                                                                                                                         |-------------------------------------| |-------------------------------------| |-------------------------------------| */


/* Right Hand */

                                        /* |-------------------------------------| |-------------------------------------| |-------------------------------------| |-------------------------------------| |-------------------------------------| */
                                        /* │                F6                   │ │                   F7                │ │                  F8                 │ │                 F9                  │ │                 F10                 │ */
                                                          &trans                                    &kp J                                   &kp K                                   &kp L                                  &kp SEMI
/* |-------------------------------------| |-------------------------------------| |-------------------------------------| |-------------------------------------| |-------------------------------------| |-------------------------------------| */
/* │                 6                   │ │                 7                   │ │                   8                 │ │                  9                  │ │                 0                   │ │                  -                  │ */
                  &trans                                    &trans                                  &HRM_left_middy_tap_v1B_TKZ Z                                  &HRM_left_middy_tap_v1B_TKZ X                                 &HRM_left_middy_tap_v1B_TKZ C                                   &HRM_left_middy_tap_v1B_TKZ V
/* |-------------------------------------| |-------------------------------------| |-------------------------------------| |-------------------------------------| |-------------------------------------| |-------------------------------------| */
/* │                 Y                   │ │                  U                  │ │                  I                  │ │                   O                 │ │                 P                   │ │                  ()                 │ */
                  &HRM_left_middy_tap_v1B_TKZ B                                                          &trans                                  &trans                                  &trans                                 &trans                                   &trans
/* |-------------------------------------| |-------------------------------------| |-------------------------------------| |-------------------------------------| |-------------------------------------| |-------------------------------------| */
/* │                ---                  │ │                  J                  │ │                  K                  │ │                  L                  │ │                SEMI                 │ │                  ---                │ */
                  &trans                                    &trans                                   &trans                                   &trans                                  &trans                                  &trans
/* |-------------------------------------| |-------------------------------------| |-------------------------------------| |-------------------------------------| |-------------------------------------| |-------------------------------------| */
/* │                N                    │ │                  M                  │ │                 ,                   │ │                  .                  │ │                  /                  │ │                   ---               │ */
                  &trans                                   &trans                                   &trans                                  &trans                                 &trans                                                                                                                                                                                                 &trans
/* |-------------------------------------| |-------------------------------------| |-------------------------------------| |-------------------------------------| |-------------------------------------| |-------------------------------------| */
                                        /* │               LCTRL                 │ │                  LALT               │ │                 LGUI                │ │                  ---                │ │                   ---               │ */
                                                          &trans                                    &trans                                   &trans                                                                       &trans                                    &trans
                                        /* |-------------------------------------| |-------------------------------------| |-------------------------------------| |-------------------------------------| |-------------------------------------| */

                    /* |-------------------------------------| |-------------------------------------| |-------------------------------------| */
                    /* │                 ---                 │ │                  ---                │ │                  ---                │ */
                                        &trans                                  &trans                                   &trans
                    /* |-------------------------------------| |-------------------------------------| |-------------------------------------| */
                    /* |-------------------------------------| |-------------------------------------| |-------------------------------------| */
                    /* │                 ---                 │ │                  ---                │ │                  ---                │ */
                                        &trans                                  &trans                                   &trans
                    /* |-------------------------------------| |-------------------------------------| |-------------------------------------| */

            >;
        };
