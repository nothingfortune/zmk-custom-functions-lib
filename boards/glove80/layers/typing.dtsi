/* glove80 — LAYER 1: Typing - Plain ASDF homerow (no HRM)
 * see boards/go60/layers/typing.dtsi */

        LAYER_Typing {
            bindings = <

    /* Left Hand */

/* |-------------------------------------| |-------------------------------------| |-------------------------------------| |-------------------------------------| |-------------------------------------| */
/* │              ESC/`                  │ │                   F1                │ │                F2                   │ │                 F3                  │ │                  F4                 │ */
                  &trans                                     &trans                                &trans                                  &trans                                   &trans
/* |-------------------------------------| |-------------------------------------| |-------------------------------------| |-------------------------------------| |-------------------------------------| |-------------------------------------| */
/* │              EQUAL                  │ │                   1/!               │ │                2/@                  │ │                 3/#                 │ │                  4/$                │ │                5/%                  │ */
                  &trans                                     &trans                                &trans                                  &trans                                   &trans                                 &trans
/* |-------------------------------------| |-------------------------------------| |-------------------------------------| |-------------------------------------| |-------------------------------------| |-------------------------------------| */
/* │               TAB                   │ │                    Q                │ │                 W                   │ │                 E                   │ │                   R                 │ │                 T                   │ */
                  &trans                                     &trans                                &trans                                  &trans                                   &trans                                 &trans
/* |-------------------------------------| |-------------------------------------| |-------------------------------------| |-------------------------------------| |-------------------------------------| |-------------------------------------| */
/* │         Lshift + 2xCAPSLCK          │ │                  A                  │ │                  S                  │ │                 D                   │ │                  F                  │ │                ---                  │ */
                  &trans                                     &trans                                 &trans                                   &trans                                    &trans                                  &trans
/* |-------------------------------------| |-------------------------------------| |-------------------------------------| |-------------------------------------| |-------------------------------------| |-------------------------------------| */
/* │               SHIFT                 │ │                    Z                │ │                  X                  │ │                 C                   │ │                   V                 │ │                 B                   │ */
                  &trans                                     &trans                                &trans                                  &trans                                   &trans                                 &trans
/* |-------------------------------------| |-------------------------------------| |-------------------------------------| |-------------------------------------| |-------------------------------------| |-------------------------------------| */
/* │               MAGIC                 │ │                 LCTRL               │ │                 LALT                │ │                LGUI                 │ │                  ---                │ */
          &trans                              &trans                                 &trans                                  &trans                                   &trans
/* |-------------------------------------| |-------------------------------------| |-------------------------------------| |-------------------------------------| |-------------------------------------| */
/*                                                                                                                         |-------------------------------------| |-------------------------------------| |-------------------------------------| */
/*                                                                                                                         │                 ---                 │ │                  ---                │ │                  ---                │ */
                                                                                                                                           &trans                                  &kp A                                   &kp S
/*                                                                                                                         |-------------------------------------| |-------------------------------------| |-------------------------------------| */
/*                                                                                                                         |-------------------------------------| |-------------------------------------| |-------------------------------------| */
/*                                                                                                                         │                 ---                 │ │                  ---               │ │                  ---                │ */
                                                                                                                                           &kp D                                  &kp F                                   &trans
/*                                                                                                                         |-------------------------------------| |-------------------------------------| |-------------------------------------| */


/* Right Hand */

                                        /* |-------------------------------------| |-------------------------------------| |-------------------------------------| |-------------------------------------| |-------------------------------------| */
                                        /* │                F6                   │ │                   F7                │ │                  F8                 │ │                 F9                  │ │                 F10                 │ */
                                                          &trans                                    &kp J                                  &kp K                                  &kp L                                  &kp SEMI
/* |-------------------------------------| |-------------------------------------| |-------------------------------------| |-------------------------------------| |-------------------------------------| |-------------------------------------| */
/* │                 6                   │ │                 7                   │ │                   8                 │ │                  9                  │ │                 0                   │ │                  -                  │ */
                  &trans                                    &magic LAYER_Magic 0                                  &trans                                  &trans                                 &trans                                   &trans
/* |-------------------------------------| |-------------------------------------| |-------------------------------------| |-------------------------------------| |-------------------------------------| |-------------------------------------| */
/* │                 Y                   │ │                 U                   │ │                  I                  │ │                   O                 │ │                 P                   │ │                  ()                 │ */
                  &trans                                    &trans                                  &trans                                  &trans                                 &trans                                   &trans
/* |-------------------------------------| |-------------------------------------| |-------------------------------------| |-------------------------------------| |-------------------------------------| |-------------------------------------| */
/* │                ---                  │ │                  J                  │ │                  K                  │ │                  L                  │ │                SEMI                 │ │                  ---                │ */
                  &trans                                    &trans                                   &trans                                   &trans                                  &trans                                 &trans
/* |-------------------------------------| |-------------------------------------| |-------------------------------------| |-------------------------------------| |-------------------------------------| |-------------------------------------| */
/* │                N                    │ │                  M                  │ │                 ,/<>                │ │                  .                  │ │                  /                  │ │                   ---               │ */
                  &trans                                   &trans                                   &trans                                  &trans                                 &trans                                   &trans
/* |-------------------------------------| |-------------------------------------| |-------------------------------------| |-------------------------------------| |-------------------------------------| |-------------------------------------| */
                                        /* │               LCTRL                 │ │                  LALT               │ │                 LGUI                │ │                  ---                │ │                   ---               │ */
                                                          &trans                                   &trans                                   &trans                                 &trans                                   &trans
                                        /* |-------------------------------------| |-------------------------------------| |-------------------------------------| |-------------------------------------| |-------------------------------------| */

                    /* |-------------------------------------| |-------------------------------------| |-------------------------------------| */
                    /* │                 ---                 │ │                  ---                │ │                  ---                │ */
                                        &trans                                  &trans                                  &trans
                    /* |-------------------------------------| |-------------------------------------| |-------------------------------------| */
                    /* |-------------------------------------| |-------------------------------------| |-------------------------------------| */
                    /* │                 ---                 │ │                  ---                │ │                  ---                │ */
                                        &trans                                  &trans                                  &trans
                    /* |-------------------------------------| |-------------------------------------| |-------------------------------------| */

                            >;
                        };
