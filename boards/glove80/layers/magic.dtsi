/* glove80 — LAYER 18: Magic / System
 * see boards/go60/layers/magic.dtsi */

        LAYER_Magic {
            bindings = <

    /* Left Hand */

/* |-------------------------------------| |-------------------------------------| |-------------------------------------| |-------------------------------------| |-------------------------------------| */
/* │                ---                  │ │                 F1                  │ │                F2                   │ │                 F3                  │ │                  F4                 │ */
                  &trans                                     &trans                                &trans                                  &trans                                   &trans
/* |-------------------------------------| |-------------------------------------| |-------------------------------------| |-------------------------------------| |-------------------------------------| |-------------------------------------| */
/* │                ---                  │ │             BRI DOWN                │ │             BRI UP                  │ │              PREV                   │ │               NEXT                  │ │               PLAY                  │ */
                  &trans                                 &kp C_BRI_DN                          &kp C_BRI_UP                            &kp C_PREV                               &kp C_NEXT                             &trans
/* |-------------------------------------| |-------------------------------------| |-------------------------------------| |-------------------------------------| |-------------------------------------| |-------------------------------------| */
/* │            BOOTLOADER               │ │             RGB SPI                 │ │             RGB SAI                 │ │             RGB HUI                 │ │              RGB BRI                │ │             RGB TOG                 │ */
                &kp C_BRI_DN                           &kp C_BRI_UP                         &kp C_PREV                         &kp C_NEXT                          &kp C_PP                       &kp C_MUTE
/* |-------------------------------------| |-------------------------------------| |-------------------------------------| |-------------------------------------| |-------------------------------------| |-------------------------------------| */
/* │             SYS RESET               │ │             RGB SPD                 │ │             RGB SAD                 │ │             RGB HUD                 │ │              RGB BRD                │ │             RGB EFF                 │ */
                &kp C_VOL_DN                            &kp C_VOL_UP                          &trans                        &bt BT_CLR                        &bt BT_CLR                          &bootloader
/* |-------------------------------------| |-------------------------------------| |-------------------------------------| |-------------------------------------| |-------------------------------------| |-------------------------------------| */
/* │               SHIFT                 │ │                ---                  │ │               BT_0                  │ │               BT_1                  │ │               BT_2                  │ │               BT_3                  │ */
                  &rgb_ug RGB_SPI                                   &rgb_ug RGB_SAI                                   &rgb_ug RGB_HUI                                   &rgb_ug RGB_BRI                                    &rgb_ug RGB_TOG                                  &none
/* |-------------------------------------| |-------------------------------------| |-------------------------------------| |-------------------------------------| |-------------------------------------| |-------------------------------------| */
/* │               ---                   │ │           USB Priority              │ │                ---                  │ │          TO Typing                  │ │                  ---                │ */
                  &none                                  &none                               &none                              &none                             &bootloader
/* |-------------------------------------| |-------------------------------------| |-------------------------------------| |-------------------------------------| |-------------------------------------| */

/*                                                                                                                         |-------------------------------------| |-------------------------------------| |-------------------------------------| */
/*                                                                                                                         │                 ---                 │ │                ---                  │ │                  ---                │ */
                                                                                                                                           &sys_reset                                  &rgb_ug RGB_SPD                                   &rgb_ug RGB_SAD
/*                                                                                                                         |-------------------------------------| |-------------------------------------| |-------------------------------------| */
/*                                                                                                                         |-------------------------------------| |-------------------------------------| |-------------------------------------| */
/*                                                                                                                         │                 ---                 │ │                ---                  │ │                  ---                │ */
                                                                                                                                           &rgb_ug RGB_HUD                                  &rgb_ug RGB_BRD                                   &rgb_ug RGB_EFF
/*                                                                                                                         |-------------------------------------| |-------------------------------------| |-------------------------------------| */


/* Right Hand */

                                        /* |-------------------------------------| |-------------------------------------| |-------------------------------------| |-------------------------------------| |-------------------------------------| */
                                        /* │                F6                   │ │                   F7                │ │                  F8                 │ │                 F9                  │ │                 F10                 │ */
                                                          &none                                    &none                                  &none                                 &none                                  &none
/* |-------------------------------------| |-------------------------------------| |-------------------------------------| |-------------------------------------| |-------------------------------------| |-------------------------------------| */
/* │               MUTE                  │ │             VOL DOWN                │ │             VOL UP                  │ │                 ---                 │ │              BT CLR                 │ │              BT CLR                 │ */
                &sys_reset                             &none                            &none                                &bt_0                               &bt_1                               &bt_2
/* |-------------------------------------| |-------------------------------------| |-------------------------------------| |-------------------------------------| |-------------------------------------| |-------------------------------------| */
/* │               ---                   │ │                ---                  │ │                ---                  │ │                ---                  │ │                ---                  │ │            BOOTLOADER               │ */
                  &bt_3                                     &none                                   &none                                   &none                                  &none                                 &bootloader
/* |-------------------------------------| |-------------------------------------| |-------------------------------------| |-------------------------------------| |-------------------------------------| |-------------------------------------| */
/* │               ---                   │ │                ---                  │ │                ---                  │ │                ---                  │ │                ---                  │ │             SYS RESET               │ */
                  &none                                     &none                                   &none                                   &none                                  &none                                  &none
/* |-------------------------------------| |-------------------------------------| |-------------------------------------| |-------------------------------------| |-------------------------------------| |-------------------------------------| */
/* │               ---                   │ │                ---                  │ │                ---                  │ │                ---                  │ │                ---                  │ │                  ---                │ */
                  &trans                                     &none                                   &out OUT_USB                                   &none                                  &to LAYER_Typing                                    &trans
/* |-------------------------------------| |-------------------------------------| |-------------------------------------| |-------------------------------------| |-------------------------------------| |-------------------------------------| */
                                        /* │               LCTRL                 │ │                  LALT               │ │                 LGUI                │ │                  ---                │ │                   ---               │ */
                                                          &trans                                   &trans                                   &trans                                 &mac_tab_prev                                   &trans
                                        /* |-------------------------------------| |-------------------------------------| |-------------------------------------| |-------------------------------------| |-------------------------------------| */

                    /* |-------------------------------------| |-------------------------------------| |-------------------------------------| */
                    /* │             Prev Tab                │ │                 ---                 │ │              Next Tab               │ */
                        &mac_tab_next                                          &trans                                &trans
                    /* |-------------------------------------| |-------------------------------------| |-------------------------------------| */
                    /* |-------------------------------------| |-------------------------------------| |-------------------------------------| */
                    /* │             Prev Tab                │ │                 ---                 │ │              Next Tab               │ */
                           &trans                                       &trans                                &mac_tab_next
                    /* |-------------------------------------| |-------------------------------------| |-------------------------------------| */

            >;
        };
