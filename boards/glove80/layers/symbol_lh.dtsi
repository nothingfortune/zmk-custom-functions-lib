/* glove80 — LAYER 13: Symbol
 * see boards/go60/layers/symbol.dtsi */

        LAYER_Symbol {
            bindings = <

    /* Left Hand */

/* |-------------------------------------| |-------------------------------------| |-------------------------------------| |-------------------------------------| |-------------------------------------| */
/* │               NONE                  │ │                   F1                │ │                F2                   │ │                 F3                  │ │                  F4                 │ */
                  &none                                      &trans                                &trans                                  &trans                                   &trans
/* |-------------------------------------| |-------------------------------------| |-------------------------------------| |-------------------------------------| |-------------------------------------| |-------------------------------------| */
/* │                ---                  │ │               NONE                  │ │               NONE                  │ │               NONE                  │ │               NONE                  │ │               NONE                  │ */
                  &trans                                     &none                                 &none                                   &none                                    &none                                  &trans
/* |-------------------------------------| |-------------------------------------| |-------------------------------------| |-------------------------------------| |-------------------------------------| |-------------------------------------| */
/* │               NONE                  │ │                  ~                  │ │                  $                  │ │                  #                  │ │                  ^                  │ │               NONE                  │ */
                  &trans                                   &trans                             &trans                               &trans                                &trans                                 &trans
/* |-------------------------------------| |-------------------------------------| |-------------------------------------| |-------------------------------------| |-------------------------------------| |-------------------------------------| */
/* │             CAPS WORD               │ │                  -                  │ │                  *                  │ │                  |                  │ │                  &                  │ │               NONE                  │ */
                &trans                               &trans                               &trans                                &trans                                &trans                                  &trans
/* |-------------------------------------| |-------------------------------------| |-------------------------------------| |-------------------------------------| |-------------------------------------| |-------------------------------------| */
/* │               SHIFT                 │ │                  {                  │ │                  }                  │ │                 <>                  │ │                  >                  │ │               NONE                  │ */
                  &trans                                &trans                              &trans                               &trans                               &trans                                    &trans
/* |-------------------------------------| |-------------------------------------| |-------------------------------------| |-------------------------------------| |-------------------------------------| |-------------------------------------| */
/* │               MAGIC                 │ │                 LCTRL               │ │                 LALT                │ │                LGUI                 │ │                  ---                │ */
          &kp UNDER                              &kp AT                                 &kp PRCNT                                  &kp GRAVE                                   &kp COLON
/* |-------------------------------------| |-------------------------------------| |-------------------------------------| |-------------------------------------| |-------------------------------------| |-------------------------------------| */

/*                                                                                                                         |-------------------------------------| |-------------------------------------| |-------------------------------------| */
/*                                                                                                                         │             TO BASE                 │ │                  ---               │ │                  ---                │ */
                                                                                                                                      &caps_word                               &trans                                   &trans
/*                                                                                                                         |-------------------------------------| |-------------------------------------| |-------------------------------------| */
/*                                                                                                                         |-------------------------------------| |-------------------------------------| |-------------------------------------| */
/*                                                                                                                         │             TO BASE                 │ │                  ---               │ │                  ---                │ */
                                                                                                                                      &trans                               &trans                                   &kp G
/*                                                                                                                         |-------------------------------------| |-------------------------------------| |-------------------------------------| */


/* Right Hand */

                                        /* |-------------------------------------| |-------------------------------------| |-------------------------------------| |-------------------------------------| |-------------------------------------| */
                                        /* │                F6                   │ │                   F7                │ │                  F8                 │ │                 F9                  │ │                 F10                 │ */
                                                          &trans                                    &pair_paren                                  &kp RPAR                                  &kp PLUS                                  &kp EQUAL
/* |-------------------------------------| |-------------------------------------| |-------------------------------------| |-------------------------------------| |-------------------------------------| |-------------------------------------| */
/* │               NONE                  │ │               NONE                  │ │               NONE                  │ │               NONE                  │ │               NONE                  │ │               NONE                  │ */
                  &kp SQT                                     &magic LAYER_Magic 0                                   &trans                                   &trans                                  &trans                                    &trans
/* |-------------------------------------| |-------------------------------------| |-------------------------------------| |-------------------------------------| |-------------------------------------| |-------------------------------------| */
/* │               NONE                  │ │                  _                  │ │                  @                  │ │                  %                  │ │                  `                  │ │                  :                  │ */
                  &trans                                   &kp UNDER                               &kp AT                                 &kp PRCNT                               &kp GRAVE                               &kp COLON
/* |-------------------------------------| |-------------------------------------| |-------------------------------------| |-------------------------------------| |-------------------------------------| |-------------------------------------| */
/* │               NONE                  │ │                  ()                 │ │                  )                  │ │                  +                  │ │                  =                  │ │                  '                  │ */
                  &none                                 &trans                              &pair_bracket                                 &kp RBKT                               &kp EXCL                                &kp QMARK
/* |-------------------------------------| |-------------------------------------| |-------------------------------------| |-------------------------------------| |-------------------------------------| |-------------------------------------| */
/* │               NONE                  │ │                  []                 │ │                  ]                  │ │                  !                  │ │                  ?                  │ │                  ---                │ */
                  &trans                               &pair_bracket                              &trans                                 &trans                               &trans                                 &trans
/* |-------------------------------------| |-------------------------------------| |-------------------------------------| |-------------------------------------| |-------------------------------------| |-------------------------------------| */
                                        /* │               LCTRL                 │ │                  LALT               │ │                 LGUI                │ │                  ---                │ │                   ---               │ */
                                                          &to LAYER_Base                                   &trans                                   &trans                                 &trans                                   &trans
                                        /* |-------------------------------------| |-------------------------------------| |-------------------------------------| |-------------------------------------| |-------------------------------------| */

                    /* |-------------------------------------| |-------------------------------------| |-------------------------------------| */
                    /* │                 ---                 │ │                  ---               │ │                  ---                │ */
                        &trans        &trans          &trans
                    /* |-------------------------------------| |-------------------------------------| |-------------------------------------| */
                    /* |-------------------------------------| |-------------------------------------| |-------------------------------------| */
                    /* │                 ---                 │ │                  ---               │ │                  ---                │ */
                           &trans        &trans          &trans
                    /* |-------------------------------------| |-------------------------------------| |-------------------------------------| */

            >;
        };
