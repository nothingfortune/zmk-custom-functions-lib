/* glove80 — LAYER 8: RightRingy HRM - ALT hold
 * see boards/go60/layers/hrm_right_ring.dtsi */

        LAYER_RightRingy {
            bindings = <

    /* Left Hand */

/* |-------------------------------------| |-------------------------------------| |-------------------------------------| |-------------------------------------| |-------------------------------------| */
/* │              ESC/`                  │ │                   F1                │ │                F2                   │ │                 F3                  │ │                  F4                 │ */
                  &trans                                     &trans                                &trans                                  &trans                                   &trans
/* |-------------------------------------| |-------------------------------------| |-------------------------------------| |-------------------------------------| |-------------------------------------| |-------------------------------------| */
/* │              EQUAL                  │ │                   1/!               │ │                2/@                  │ │                 3/#                 │ │                  4/$                │ │                5/%                  │ */
                  &trans                                     &trans                                &trans                                  &trans                                   &trans                                 &trans
/* |-------------------------------------| |-------------------------------------| |-------------------------------------| |-------------------------------------| |-------------------------------------| |-------------------------------------| */
/* │               TAB                   │ │                    Q                │ │                 W                   │ │                 E                   │ │                   R                 │ │                 T                   │ */
                  &trans                                     &trans                                  &trans                                   &trans                                   &trans                                                                        &trans
/* |-------------------------------------| |-------------------------------------| |-------------------------------------| |-------------------------------------| |-------------------------------------| |-------------------------------------| */
/* │                ---                  │ │                  A                  │ │                  S                  │ │                 D                   │ │                  F                  │ │                ---                  │ */
                  &trans                                     &trans                                  &trans                                   &trans                                    &trans                                  &trans
/* |-------------------------------------| |-------------------------------------| |-------------------------------------| |-------------------------------------| |-------------------------------------| |-------------------------------------| */
/* │               SHIFT                 │ │                    Z                │ │                  X                  │ │                 C                   │ │                   V                 │ │                 B                   │ */
                  &trans                                     &trans                                  &trans                                   &trans                                   &trans                                                            &HRM_right_ring_tap_v1B_TKZ Y
/* |-------------------------------------| |-------------------------------------| |-------------------------------------| |-------------------------------------| |-------------------------------------| |-------------------------------------| */
/* │                ---                  │ │                 LCTRL               │ │                 LALT                │ │                LGUI                 │ │                  ---                │ */
                  &HRM_right_ring_tap_v1B_TKZ U                                     &HRM_right_ring_tap_v1B_TKZ I                                 &HRM_right_ring_tap_v1B_TKZ O                                  &HRM_right_ring_tap_v1B_TKZ P                                   &trans
/* |-------------------------------------| |-------------------------------------| |-------------------------------------| |-------------------------------------| |-------------------------------------| */

/*                                                                                                                         |-------------------------------------| |-------------------------------------| |-------------------------------------| */
/*                                                                                                                         │                 ---                 │ │                  ---               │ │                  ---                │ */
                                                                                                                                           &trans                                     &kp A                                   &kp S
/*                                                                                                                         |-------------------------------------| |-------------------------------------| |-------------------------------------| */
/*                                                                                                                         |-------------------------------------| |-------------------------------------| |-------------------------------------| */
/*                                                                                                                         │                 ---                 │ │                  ---               │ │                  ---                │ */
                                                                                                                                           &kp D                                     &kp F                                   &trans
/*                                                                                                                         |-------------------------------------| |-------------------------------------| |-------------------------------------| */


/* Right Hand */

                                        /* |-------------------------------------| |-------------------------------------| |-------------------------------------| |-------------------------------------| |-------------------------------------| */
                                        /* │                F6                   │ │                   F7                │ │                  F8                 │ │                 F9                  │ │                 F10                 │ */
                                                          &HRM_right_ring_tap_v1B_TKZ H                                    &HRM_right_ring_index_v1B_TKZ RSHFT J                                  &HRM_right_ring_middy_v1B_TKZ RCTRL K                                  &none                                  &HRM_right_ring_pinky_v1B_TKZ LGUI SEMI
/* |-------------------------------------| |-------------------------------------| |-------------------------------------| |-------------------------------------| |-------------------------------------| |-------------------------------------| */
/* │                 6                   │ │                 7                   │ │                   8                 │ │                  9                  │ │                 0                   │ │                  -                  │ */
                  &trans                                    &trans                                     &trans                                  &trans                                 &trans                                    &trans
/* |-------------------------------------| |-------------------------------------| |-------------------------------------| |-------------------------------------| |-------------------------------------| |-------------------------------------| */
/* │               Y(HRM)                │ │              U(HRM)                 │ │              I(HRM)                 │ │              O(HRM)                 │ │              P(HRM)                 │ │                  ()                 │ */
          &trans                                                            &HRM_right_ring_tap_v1B_TKZ U           &HRM_right_ring_tap_v1B_TKZ I           &HRM_right_ring_tap_v1B_TKZ O          &HRM_right_ring_tap_v1B_TKZ P                    &trans
/* |-------------------------------------| |-------------------------------------| |-------------------------------------| |-------------------------------------| |-------------------------------------| |-------------------------------------| */
/* │               H(HRM)                │ │         SHIFT(hold)/J               │ │          CTRL(hold)/K               │ │                  ---                │ │          GUI(hold)/;                │ │                  ---                │ */
          &HRM_right_ring_tap_v1B_TKZ H     &HRM_right_ring_tap_v1B_TKZ N          &HRM_right_ring_tap_v1B_TKZ M                &HRM_right_ring_tap_v1B_TKZ COMMA                     &HRM_right_ring_tap_v1B_TKZ DOT                 &HRM_right_ring_tap_v1B_TKZ QMARK
/* |-------------------------------------| |-------------------------------------| |-------------------------------------| |-------------------------------------| |-------------------------------------| |-------------------------------------| */
/* │               N(HRM)                │ │              M(HRM)                 │ │            COMMA(HRM)               │ │              DOT(HRM)               │ │             QMARK(HRM)              │ │                   ---               │ */
          &trans            &HRM_right_ring_tap_v1B_TKZ M          &trans                                &trans                                 &trans                                                                                                                                                          &trans
/* |-------------------------------------| |-------------------------------------| |-------------------------------------| |-------------------------------------| |-------------------------------------| |-------------------------------------| */
                                        /* │               LCTRL                 │ │                  LALT               │ │                 LGUI                │ │                  ---                │ │                   ---               │ */
                                                          &trans                                    &trans                                   &trans                                                                       &trans                                    &trans
                                        /* |-------------------------------------| |-------------------------------------| |-------------------------------------| |-------------------------------------| |-------------------------------------| */

                    /* |-------------------------------------| |-------------------------------------| |-------------------------------------| */
                    /* │                 ---                 │ │                  ---               │ │                  ---                │ */
                                        &trans                                  &trans                                   &trans
                    /* |-------------------------------------| |-------------------------------------| |-------------------------------------| */
                    /* |-------------------------------------| |-------------------------------------| |-------------------------------------| */
                    /* │                 ---                 │ │                  ---               │ │                  ---                │ */
                                        &trans                                    &trans                                   &trans
                    /* |-------------------------------------| |-------------------------------------| |-------------------------------------| */

            >;
        };
