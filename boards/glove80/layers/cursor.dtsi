/* glove80 — LAYER 11: Cursor / Navigation
 * see boards/go60/layers/cursor.dtsi */

        LAYER_Cursor {
            bindings = <

    /* Left Hand */

/* |-------------------------------------| |-------------------------------------| |-------------------------------------| |-------------------------------------| |-------------------------------------| */
/* │                ---                  │ │                   F1                │ │                F2                   │ │                 F3                  │ │                  F4                 │ */
                  &trans                                     &trans                                &trans                                  &trans                                   &trans
/* |-------------------------------------| |-------------------------------------| |-------------------------------------| |-------------------------------------| |-------------------------------------| |-------------------------------------| */
/* │                ---                  │ │                   ---               │ │               NONE                  │ │                 ---                 │ │            RIGHT CLICK              │ │              ZOOM IN                │ */
                  &trans                                     &trans                                &none                                   &trans                                &mkp RCLK                              &trans
/* |-------------------------------------| |-------------------------------------| |-------------------------------------| |-------------------------------------| |-------------------------------------| |-------------------------------------| */
/* │                ---                  │ │                   ---               │ │               NONE                  │ │              MOUSE UP               │ │            LEFT CLICK               │ │              ZOOM OUT               │ */
                  &trans                                     &none                                &trans                               &mkp RCLK                             &kp LG(PLUS)                              &msc SCRL_UP
/* |-------------------------------------| |-------------------------------------| |-------------------------------------| |-------------------------------------| |-------------------------------------| |-------------------------------------| */
/* │                ---                  │ │               NONE                  │ │            MOUSE LEFT               │ │             MOUSE DOWN              │ │           MOUSE RIGHT               │ │               NONE                  │ */
                  &trans                                     &trans                             &trans                          &trans                         &trans                              &trans
/* |-------------------------------------| |-------------------------------------| |-------------------------------------| |-------------------------------------| |-------------------------------------| |-------------------------------------| */
/* │               NONE                  │ │               NONE                  │ │               NONE                  │ │             MOUSEFAST               │ │             MOUSEWARP               │ │             MOUSESLOW               │ */
                  &trans                                      &none                                 &mmv MOVE_UP                             &mkp LCLK                     &kp LG(MINUS)                     &msc SCRL_DOWN
/* |-------------------------------------| |-------------------------------------| |-------------------------------------| |-------------------------------------| |-------------------------------------| |-------------------------------------| */
/* │                ---                  │ │                 LCTRL               │ │                 LALT                │ │                LGUI                 │ │                  ---                │ */
                  &trans                                     &mmv MOVE_UP                                 &trans                                  &trans                                   &trans
/* |-------------------------------------| |-------------------------------------| |-------------------------------------| |-------------------------------------| |-------------------------------------| */

/*                                                                                                                         |-------------------------------------| |-------------------------------------| |-------------------------------------| */
/*                                                                                                                         │               DEL                   │ │            RIGHT CLICK              │ │            LEFT MOUSE               │ */
                                                                                                                                          &trans                                &none                                 &mmv MOVE_LEFT
/*                                                                                                                         |-------------------------------------| |-------------------------------------| |-------------------------------------| */
/*                                                                                                                         |-------------------------------------| |-------------------------------------| |-------------------------------------| */
/*                                                                                                                         │               DEL                   │ │            RIGHT CLICK              │ │            LEFT MOUSE               │ */
                                                                                                                                          &mmv MOVE_DOWN                                &mmv MOVE_RIGHT                                 &none
/*                                                                                                                         |-------------------------------------| |-------------------------------------| |-------------------------------------| */


/* Right Hand */

                                        /* |-------------------------------------| |-------------------------------------| |-------------------------------------| |-------------------------------------| |-------------------------------------| */
                                        /* │                F6                   │ │                   F7                │ │                  F8                 │ │                 F9                  │ │                 F10                 │ */
                                                          &trans                                    &mmv MOVE_LEFT                                  &mmv MOVE_DOWN                                  &mmv MOVE_RIGHT                                  &trans
/* |-------------------------------------| |-------------------------------------| |-------------------------------------| |-------------------------------------| |-------------------------------------| |-------------------------------------| */
/* │            SCROLL UP                │ │                 ---                 │ │                 ---                 │ │                 ---                 │ │                ---                  │ │                  ---                │ */
             &trans                                   &none                                  &none                                  &none                                 &mo LAYER_MouseFast                                   &mo LAYER_MouseWarp
/* |-------------------------------------| |-------------------------------------| |-------------------------------------| |-------------------------------------| |-------------------------------------| |-------------------------------------| */
/* │           SCROLL DOWN               │ │                 ---                 │ │              MOVE UP                │ │                 ---                 │ │                ---                  │ │                  ---                │ */
            &mo LAYER_MouseSlow                                  &trans                              &mmv MOVE_UP                                &trans                                 &trans                                   &trans
/* |-------------------------------------| |-------------------------------------| |-------------------------------------| |-------------------------------------| |-------------------------------------| |-------------------------------------| */
/* │                ---                  │ │            MOVE LEFT                │ │             MOVE DOWN               │ │            MOVE RIGHT               │ │                ---                  │ │                  ---                │ */
                  &trans                               &mo LAYER_MouseSlow                          &mo LAYER_MouseFast                          &mo LAYER_MouseWarp                            &none                                   &trans
/* |-------------------------------------| |-------------------------------------| |-------------------------------------| |-------------------------------------| |-------------------------------------| |-------------------------------------| */
/* │             MOUSESLOW               │ │             MOUSEFAST               │ │             MOUSEWARP               │ │               NONE                  │ │                ---                  │ │                  ---                │ */
            &trans                      &mo LAYER_MouseFast                     &trans                            &trans                                  &trans                                   &trans
/* |-------------------------------------| |-------------------------------------| |-------------------------------------| |-------------------------------------| |-------------------------------------| |-------------------------------------| */
                                        /* │               LCTRL                 │ │                  LALT               │ │                 LGUI                │ │                  ---                │ │                   ---               │ */
                                                          &kp DEL                                   &mkp RCLK                                   &mkp LCLK                                 &mkp LCLK                                   &mkp RCLK
                                        /* |-------------------------------------| |-------------------------------------| |-------------------------------------| |-------------------------------------| |-------------------------------------| */

                    /* |-------------------------------------| |-------------------------------------| |-------------------------------------| */
                    /* │            LEFT MOUSE               │ │            RIGHT MOUSE              │ │                 ---                 │ */
                        &trans        &mkp RCLK          &trans
                    /* |-------------------------------------| |-------------------------------------| |-------------------------------------| */
                    /* |-------------------------------------| |-------------------------------------| |-------------------------------------| */
                    /* │            LEFT MOUSE               │ │            RIGHT MOUSE              │ │                 ---                 │ */
                           &trans        &trans          &trans
                    /* |-------------------------------------| |-------------------------------------| |-------------------------------------| */

            >;
        };
