/* glove80 — LAYER 13: Symbol
 * see boards/go60/layers/symbol.dtsi */

        LAYER_Symbol_rh {
            bindings = <

    /* Left Hand */

/* |-------------------------------------| |-------------------------------------| |-------------------------------------| |-------------------------------------| |-------------------------------------| */
/* │               NONE                  │ │                   F1                │ │                F2                   │ │                 F3                  │ │                  F4                 │ */
                  &none                                      &trans                                &trans                                  &trans                                   &trans
/* |-------------------------------------| |-------------------------------------| |-------------------------------------| |-------------------------------------| |-------------------------------------| |-------------------------------------| */
/* │                ---                  │ │               NONE                  │ │               NONE                  │ │               NONE                  │ │               NONE                  │ │               NONE                  │ */
                  &trans                                     &none                                 &none                                   &none                                    &none                                  &trans
/* |-------------------------------------| |-------------------------------------| |-------------------------------------| |-------------------------------------| |-------------------------------------| |-------------------------------------| */
/* │               NONE                  │ │                  ~                  │ │                  $                  │ │                  #                  │ │                  ^                  │ │               NONE                  │ */
                  &trans                                   &trans                                  &trans                                  &trans                                    &trans                                                                       &trans
/* |-------------------------------------| |-------------------------------------| |-------------------------------------| |-------------------------------------| |-------------------------------------| |-------------------------------------| */
/* │             CAPS WORD               │ │                  -                  │ │                  *                  │ │                  |                  │ │                  &                  │ │               NONE                  │ */
                &trans                                  &trans                                  &trans                                  &trans                                  &trans                                  &trans
/* |-------------------------------------| |-------------------------------------| |-------------------------------------| |-------------------------------------| |-------------------------------------| |-------------------------------------| */
/* │               SHIFT                 │ │                  {                  │ │                  }                  │ │                 <>                  │ │                  >                  │ │               NONE                  │ */
                  &kp TILDE                                &kp DOLLAR                                &kp HASH                               &kp CARET                                 &trans                                                                       &trans
/* |-------------------------------------| |-------------------------------------| |-------------------------------------| |-------------------------------------| |-------------------------------------| |-------------------------------------| */
/* │               MAGIC                 │ │                 LCTRL               │ │                 LALT                │ │                LGUI                 │ │                  ---                │ */
          &trans                                  &trans                                  &trans                                  &trans                                   &trans
/* |-------------------------------------| |-------------------------------------| |-------------------------------------| |-------------------------------------| |-------------------------------------| |-------------------------------------| */

/*                                                                                                                         |-------------------------------------| |-------------------------------------| |-------------------------------------| */
/*                                                                                                                         │             TO BASE                 │ │                  ---               │ │                  ---                │ */
                                                                                                                                      &caps_word                               &kp MINUS                                   &kp STAR
/*                                                                                                                         |-------------------------------------| |-------------------------------------| |-------------------------------------| */
/*                                                                                                                         |-------------------------------------| |-------------------------------------| |-------------------------------------| */
/*                                                                                                                         │             TO BASE                 │ │                  ---               │ │                  ---                │ */
                                                                                                                                      &kp PIPE                                  &kp AMPS                                   &trans
/*                                                                                                                         |-------------------------------------| |-------------------------------------| |-------------------------------------| */


/* Right Hand */

                                        /* |-------------------------------------| |-------------------------------------| |-------------------------------------| |-------------------------------------| |-------------------------------------| */
                                        /* │                F6                   │ │                   F7                │ │                  F8                 │ │                 F9                  │ │                 F10                 │ */
                                                          &kp H                                    &trans                                  &trans                                  &trans                                  &trans
/* |-------------------------------------| |-------------------------------------| |-------------------------------------| |-------------------------------------| |-------------------------------------| |-------------------------------------| */
/* │               NONE                  │ │               NONE                  │ │               NONE                  │ │               NONE                  │ │               NONE                  │ │               NONE                  │ */
                  &trans                                     &magic LAYER_Magic 0                                   &pair_brace                                   &kp RBRC                                  &pair_angle                                    &kp GT
/* |-------------------------------------| |-------------------------------------| |-------------------------------------| |-------------------------------------| |-------------------------------------| |-------------------------------------| */
/* │               NONE                  │ │                  _                  │ │                  @                  │ │                  %                  │ │                  `                  │ │                  :                  │ */
                  &trans                                                                       &kp UNDER                               &kp AT                                 &kp PRCNT                               &kp GRAVE                               &kp COLON
/* |-------------------------------------| |-------------------------------------| |-------------------------------------| |-------------------------------------| |-------------------------------------| |-------------------------------------| */
/* │               NONE                  │ │                  ()                 │ │                  )                  │ │                  +                  │ │                  =                  │ │                  '                  │ */
                  &none                                 &trans                                 &trans                                  &trans                                  &trans                                  &trans
/* |-------------------------------------| |-------------------------------------| |-------------------------------------| |-------------------------------------| |-------------------------------------| |-------------------------------------| */
/* │               NONE                  │ │                  []                 │ │                  ]                  │ │                  !                  │ │                  ?                  │ │                  ---                │ */
                  &trans                               &pair_bracket                              &trans                                 &trans                                   &trans                                                                                                                                                                                                &trans
/* |-------------------------------------| |-------------------------------------| |-------------------------------------| |-------------------------------------| |-------------------------------------| |-------------------------------------| */
                                        /* │               LCTRL                 │ │                  LALT               │ │                 LGUI                │ │                  ---                │ │                   ---               │ */
                                                          &to LAYER_Base                                   &trans                                   &trans                                                                      &trans                                   &trans
                                        /* |-------------------------------------| |-------------------------------------| |-------------------------------------| |-------------------------------------| |-------------------------------------| */

                    /* |-------------------------------------| |-------------------------------------| |-------------------------------------| */
                    /* │                 ---                 │ │                  ---               │ │                  ---                │ */
                        &trans        &trans          &trans
                    /* |-------------------------------------| |-------------------------------------| |-------------------------------------| */
                    /* |-------------------------------------| |-------------------------------------| |-------------------------------------| */
                    /* │                 ---                 │ │                  ---               │ │                  ---                │ */
                           &trans                                  &trans          &trans
                    /* |-------------------------------------| |-------------------------------------| |-------------------------------------| */

            >;
        };
