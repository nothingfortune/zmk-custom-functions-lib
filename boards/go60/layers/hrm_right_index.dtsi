/* Go60 layer binding - hrm_right_index.dtsi
 * Board: Go60 (go60_lh / go60_rh)
 */
/* LAYER 10: RightIndex HRM - SHIFT hold */
        LAYER_RightIndex {
            bindings = <
/*  -------------------------------------| |-------------------------------------| |-------------------------------------| |-------------------------------------| |-------------------------------------| |-------------------------------------|                                      |-------------------------------------| |-------------------------------------| |-------------------------------------| |-------------------------------------| |-------------------------------------| |-------------------------------------| */
/* │                Esc                  │ │                   1                 │ │                  2                  │ │                 3                   │ │                  4                  │ │                 5                   │                                      │                  6                  │ │                  7                  │ │                  8                  │ │                  9                  │ │                  0                  │ │                  {}                 │ */
                  &trans                                     &trans                                &trans                                  &trans                                   &trans                                 &trans                                                                        &trans                                  &trans                                  &trans                                  &trans                                 &trans                                   &trans
/* |-------------------------------------| |-------------------------------------| |-------------------------------------| |-------------------------------------| |-------------------------------------| |-------------------------------------|                                      |-------------------------------------| |-------------------------------------| |-------------------------------------| |-------------------------------------| |-------------------------------------| |-------------------------------------| */
/* │                ---                  │ │                   Q                 │ │                  W                  │ │                 E                   │ │                  R                  │ │                 T                   │                                      │                  Y                  │ │                  U                  │ │                  I                  │ │                  O                  │ │                  P                  │ │                  \|                 │ */
                  &trans                                     &trans                                &trans                                  &trans                                   &trans                                 &trans                                                            &HRM_right_index_tap_v1B_TKZ Y          &HRM_right_index_tap_v1B_TKZ U         &HRM_right_index_tap_v1B_TKZ I           &HRM_right_index_tap_v1B_TKZ O         &HRM_right_index_tap_v1B_TKZ P                       &trans
/* |-------------------------------------| |-------------------------------------| |-------------------------------------| |-------------------------------------| |-------------------------------------| |-------------------------------------|                                      |-------------------------------------| |-------------------------------------| |-------------------------------------| |-------------------------------------| |-------------------------------------| |-------------------------------------| */
/* │               CAPS                  │ │                   A                 │ │                  S                  │ │                 D                   │ │                  F                  │ │                 G                   │                                      │                 H                   │ │                  J                  │ │                  K                  │ │                 L                   │ │                SEMI                 │ │                 QUOTE               │ */
                  &trans                                     &kp A                                 &kp S                                  &kp D                                     &kp F                                  &trans                                                            &HRM_right_index_tap_v1B_TKZ H                      &none                  &HRM_right_index_middy_v1B_TKZ RCTRL K    &HRM_right_index_ring_v1B_TKZ LALT L  &HRM_right_index_pinky_v1B_TKZ LGUI SEMI                 &trans
/* |-------------------------------------| |-------------------------------------| |-------------------------------------| ├───────────────────── ───────────────┤ |-------------------------------------| |-------------------------------------|                                      |-------------------------------------| |-------------------------------------| |-------------------------------------| |-------------------------------------| |-------------------------------------| |-------------------------------------| */
/* │               MAGIC                 │ │                   Z                 │ │                 X                   │ │                 C                   │ │                  V                  │ │                 B                   │                                      │                 N                   │ │                  M                  │ │               COMMA                 │ │                DOT                  │ │               QMARK                 │ │                 LSHFT               │ */
                  &trans                                     &trans                                &trans                                 &trans                                    &trans                                 &trans                                                            &HRM_right_index_tap_v1B_TKZ N          &HRM_right_index_tap_v1B_TKZ M       &HRM_right_index_tap_v1B_TKZ COMMA       &HRM_right_index_tap_v1B_TKZ DOT                    &trans                                    &trans
/*  -------------------------------------  --------------------------------------| |-------------------------------------| |-------------------------------------| |-------------------------------------|  -------------------------------------                                        -------------------------------------  |-------------------------------------| |-------------------------------------| |-------------------------------------| ├─────────────────────────────────────┼─┼─────────────────────────────────────╯ */
/*                                                                                 │                 ---                 │ │                 ---                 │ │                ---                  │                                                                                                                      │                ---                  │ │                ---                  │ │                  ---                │ */
                                                                                                    &trans                                 &trans                                 &trans                                                                                                                                                       &trans                                  &trans                                    &trans
/*                                                                                  -------------------------------------   -------------------------------------   -------------------------------------                                                                                                                        -------------------------------------   -------------------------------------   -------------------------------------  */
/*                                                                                                                         |-------------------------------------| |-------------------------------------| |-------------------------------------|                                      |-------------------------------------| |-------------------------------------| |-------------------------------------| */
/*                                                                                                                         │                ---                  │ │                   ---               │ │                ---                  │                                      │                 ---                 │ │                  ---                │ │                 ---                 │ */
                                                                                                                                          &trans                                    &trans                                 &trans                                                                       &trans                                    &trans                                &trans 
/*                                                                                                                          -------------------------------------   -------------------------------------   -------------------------------------                                        -------------------------------------   -------------------------------------   -------------------------------------  */
            >;
        };
