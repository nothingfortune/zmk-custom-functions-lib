/* Go60 layer binding - symbol.dtsi
 * Board: Go60 (go60_lh / go60_rh)
 */
/* LAYER 13: Symbol */
        LAYER_Symbol {
            bindings = <
/*  -------------------------------------| |-------------------------------------| |-------------------------------------| |-------------------------------------| |-------------------------------------| |-------------------------------------|                                      |-------------------------------------| |-------------------------------------| |-------------------------------------| |-------------------------------------| |-------------------------------------| |-------------------------------------| */
/* │                ---                  │ │                 ---                 │ │                ---                  │ │                 ---                 │ │                ---                  │ │                  ---                │                                      │                  ---                │ │                 ---                 │ │                ---                  │ │                  ---                │ │                 ---                 │ │                 ---                 │ */
                   &none                                    &none                                  &none                                   &none                                    &none                                    &none                                                                         &none                                  &none                                 &none                                     &none                                  &none                                    &none
/* |-------------------------------------| |-------------------------------------| |-------------------------------------| |-------------------------------------| |-------------------------------------| |-------------------------------------|                                      |-------------------------------------| |-------------------------------------| |-------------------------------------| |-------------------------------------| |-------------------------------------| |-------------------------------------| */
/* │                ---                  │ │                  ~                  │ │                 $                   │ │                 #                   │ │                  ^                  │ │                  ---                │                                      │                  ---                │ │                   _                 │ │                  @                  │ │                  %                  │ │                  `                  │ │                   :                 │ */
                   &none                                  &kp TILDE                              &kp DOLLAR                                &kp HASH                                &kp CARET                                 &none                                                                         &none                                 &kp UNDER                               &kp AT                                 &kp PRCNT                               &kp GRAVE                               &kp COLON
/* |-------------------------------------| |-------------------------------------| |-------------------------------------| |-------------------------------------| |-------------------------------------| |-------------------------------------|                                      |-------------------------------------| |-------------------------------------| |-------------------------------------| |-------------------------------------| |-------------------------------------| |-------------------------------------| */
/* │             CAPS WORD               │ │                  -                  │ │                  *                  │ │                 |                   │ │                  &                  │ │                  ---                │                                      │                  ---                │ │                   ()                │ │                  )                  │ │                   +                 │ │                   =                 │ │                  '                  │ */
                 &caps_word                              &kp MINUS                               &kp STAR                                &kp PIPE                                &kp AMPS                                   &none                                                                         &none                                &pair_paren                             &kp RPAR                                 &kp PLUS                               &kp EQUAL                                &kp SQT
/* |-------------------------------------| |-------------------------------------| |-------------------------------------| |-------------------------------------| |-------------------------------------| |-------------------------------------|                                      |-------------------------------------| |-------------------------------------| |-------------------------------------| |-------------------------------------| |-------------------------------------| |-------------------------------------| */
/* │               MAGIC                 │ │                  {                  │ │                   }                 │ │                 <>                  │ │                 >                   │ │                  ---                │                                      │                  ---                │ │                   []                │ │                 ]                   │ │                  !                  │ │                  ?                  │ │                 ---                 │ */
          &magic LAYER_Magic 0                           &pair_brace                              &kp RBRC                               &pair_angle                               &kp GT                                    &none                                                                         &none                               &pair_bracket                           &kp RBKT                                 &kp EXCL                                &kp QMARK                                 &trans
/*  -------------------------------------  --------------------------------------| |-------------------------------------| |-------------------------------------| |-------------------------------------|  -------------------------------------                                        -------------------------------------  |-------------------------------------| |-------------------------------------| |-------------------------------------| ├─────────────────────────────────────┼─┼─────────────────────────────────────╯ */
/*                                         │                 ---                 │ │                ---                  │ │                 ---                 │                                                                                                                                                              │                ---                  │ │                 ---                 │ │                  ---                │ */
                                                            &trans                                &trans                                   &trans                                                                                                                                                                                                &trans                                  &trans                                  &trans
/*                                          -------------------------------------   -------------------------------------   -------------------------------------                                                                                                                                                                -------------------------------------   -------------------------------------   -------------------------------------  */
/*                                                                                                                         |-------------------------------------| |-------------------------------------| |-------------------------------------|                                      |-------------------------------------| |-------------------------------------| |-------------------------------------| */
/*                                                                                                                         │               TO BASE               │ │                  ---                │ │                  ---                │                                      │                  ---                │ │                  ---                │ │                  ---                │ */
                                                                                                                                       &to LAYER_Base                               &trans                                   &trans                                                                      &trans                                   &trans                                  &trans
/*                                                                                                                          -------------------------------------   -------------------------------------   -------------------------------------                                        -------------------------------------   -------------------------------------   -------------------------------------  */
            >;
        };
