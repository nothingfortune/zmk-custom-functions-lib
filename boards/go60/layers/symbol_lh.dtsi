/* Go60 layer binding - symbol_lh.dtsi
 * Board: Go60 (go60_lh / go60_rh)
 */
/* LAYER 19: Symbol_lh - triggered by left index (G), right hand types symbols */
        LAYER_Symbol_lh {
            bindings = <
/*  -------------------------------------| |-------------------------------------| |-------------------------------------| |-------------------------------------| |-------------------------------------| |-------------------------------------|                                      |-------------------------------------| |-------------------------------------| |-------------------------------------| |-------------------------------------| |-------------------------------------| |-------------------------------------| */
/* │                ---                  │ │                 ---                 │ │                ---                  │ │                 ---                 │ │                ---                  │ │                  ---                │                                      │                  ---                │ │                 ---                 │ │                ---                  │ │                 ---                 │ │                 ---                 │ │                 ---                 │ */
                   &trans                                    &trans                                &trans                                   &trans                                 &trans                                    &trans                                                                      &trans                                  &trans                                 &trans                                    &trans                                 &trans                                  &trans
/* |-------------------------------------| |-------------------------------------| |-------------------------------------| |-------------------------------------| |-------------------------------------| |-------------------------------------|                                      |-------------------------------------| |-------------------------------------| |-------------------------------------| |-------------------------------------| |-------------------------------------| |-------------------------------------| */
/* │                ---                  │ │                 ---                 │ │                ---                  │ │                 ---                 │ │                ---                  │ │                  ---                │                                      │                  ---                │ │                  _                  │ │                  @                  │ │                  %                  │ │                  `                  │ │                   :                 │ */
                   &trans                                    &trans                                &trans                                   &trans                                 &trans                                    &trans                                                                      &trans                                 &kp UNDER                               &kp AT                                  &kp PRCNT                               &kp GRAVE                                &kp COLON
/* |-------------------------------------| |-------------------------------------| |-------------------------------------| |-------------------------------------| |-------------------------------------| |-------------------------------------|                                      |-------------------------------------| |-------------------------------------| |-------------------------------------| |-------------------------------------| |-------------------------------------| |-------------------------------------| */
/* │             CAPS WORD               │ │                 ---                 │ │                ---                  │ │                ---                  │ │                ---                  │ │                  ---                │                                      │                  ---                │ │                  ()                 │ │                  )                  │ │                  +                  │ │                   =                 │ │                  '                  │ */
                 &caps_word                                 &trans                                 &trans                                   &trans                                 &trans                                    &kp G                                                                       &trans                                &pair_paren                             &kp RPAR                                  &kp PLUS                               &kp EQUAL                                &kp SQT
/* |-------------------------------------| |-------------------------------------| |-------------------------------------| |-------------------------------------| |-------------------------------------| |-------------------------------------|                                      |-------------------------------------| |-------------------------------------| |-------------------------------------| |-------------------------------------| |-------------------------------------| |-------------------------------------| */
/* │               MAGIC                 │ │                 ---                 │ │                 ---                 │ │                ---                  │ │                ---                  │ │                  ---                │                                      │                  ---                │ │                  []                 │ │                  ]                  │ │                  !                  │ │                   ?                  │ │                 ---                 │ */
          &magic LAYER_Magic 0                              &trans                                 &trans                                   &trans                                 &trans                                    &trans                                                                      &trans                               &pair_bracket                            &kp RBKT                                  &kp EXCL                               &kp QMARK                                 &trans
/*  -------------------------------------  --------------------------------------| |-------------------------------------| |-------------------------------------| |-------------------------------------|  -------------------------------------                                        -------------------------------------  |-------------------------------------| |-------------------------------------| |-------------------------------------| ├─────────────────────────────────────┼─┼─────────────────────────────────────╯ */
/*                                         │                 ---                 │ │                ---                  │ │                 ---                 │                                                                                                                                                              │                 ---                 │ │                 ---                 │ │                  ---                │ */
                                                            &trans                                 &trans                                   &trans                                                                                                                                                                                               &trans                                  &trans                                  &trans
/*                                          -------------------------------------   -------------------------------------   -------------------------------------                                                                                                                                                                -------------------------------------   -------------------------------------   -------------------------------------  */
/*                                                                                                                         |-------------------------------------| |-------------------------------------| |-------------------------------------|                                      |-------------------------------------| |-------------------------------------| |-------------------------------------| */
/*                                                                                                                         │               TO BASE               │ │                  ---                │ │                  ---                │                                      │                  ---                │ │                  ---                │ │                  ---                │ */
                                                                                                                                       &to LAYER_Base                               &trans                                   &trans                                                                      &trans                                  &trans                                  &trans
/*                                                                                                                          -------------------------------------   -------------------------------------   -------------------------------------                                        -------------------------------------   -------------------------------------   -------------------------------------  */
            >;
        };
