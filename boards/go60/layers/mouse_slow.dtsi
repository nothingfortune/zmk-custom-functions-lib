/* Go60 layer binding - mouse_slow.dtsi
 * Board: Go60 (go60_lh / go60_rh)
 */
/* LAYER 15: Mouse Slow */
        LAYER_MouseSlow {
            bindings = <
/*  -------------------------------------| |-------------------------------------| |-------------------------------------| |-------------------------------------| |-------------------------------------| |-------------------------------------|                                      |-------------------------------------| |-------------------------------------| |-------------------------------------| |-------------------------------------| |-------------------------------------| |-------------------------------------| */
/* │                ---                  │ │                   ---               │ │                  ---                │ │                 ---                 │ │                  ---                │ │                  ---                │                                      │                 ---                 │ │                  ---                │ │                 ---                 │ │                 ---                 │ │                ---                  │ │                  ---                │ */
                 &trans                                     &trans                                  &trans                                  &trans                                  &trans                                 &trans                                                                       &trans                                    &trans                                &trans                                    &trans                                 &trans                                     &trans
/* |-------------------------------------| |-------------------------------------| |-------------------------------------| |-------------------------------------| |-------------------------------------| |-------------------------------------|                                      |-------------------------------------| |-------------------------------------| |-------------------------------------| |-------------------------------------| |-------------------------------------| |-------------------------------------| */
/* │                ---                  │ │                   ---               │ │                  ---                │ │                 ---                 │ │                  ---                │ │                 ---                 │                                      │                 ---                 │ │                  ---                │ │                 ---                 │ │                  ---                │ │                ---                  │ │                  ---                │ */
                 &trans                                     &trans                                  &trans                                   &trans                                  &trans                                 &trans                                                                        &trans                                  &trans                                &trans                                  &trans                                 &trans                                     &trans
/* |-------------------------------------| |-------------------------------------| |-------------------------------------| |-------------------------------------| |-------------------------------------| |-------------------------------------|                                      |-------------------------------------| |-------------------------------------| |-------------------------------------| |-------------------------------------| |-------------------------------------| |-------------------------------------| */
/* │                ---                  │ │                   ---               │ │                  ---                │ │                 ---                 │ │                  ---                │ │                ---                  │                                      │                 ---                 │ │                  ---                │ │                 ---                 │ │                 ---                 │ │                ---                  │ │                   ---               │ */
                 &trans                                     &trans                                  &trans                                  &trans                                  &trans                                 &trans                                                                        &trans                                   &trans                                &trans                                   &trans                                 &trans                                     &trans
/* |-------------------------------------| |-------------------------------------| |-------------------------------------| ├─────────────────────────────────────┤ |-------------------------------------| |-------------------------------------|                                      |-------------------------------------| |-------------------------------------| |-------------------------------------| |-------------------------------------| |-------------------------------------| |-------------------------------------| */
/* │               MAGIC                 │ │                  ---                │ │                 ---                 │ │                 ---                 │ │                  ---                │ │                 ---                 │                                      │                 ---                 │ │                  ---                │ │                 ---                 │ │                 ---                 │ │                ---                  │ │                   ---               │ */
          &magic LAYER_Magic 0                              &trans                                  &trans                                  &trans                                  &trans                                 &trans                                                                        &trans                                   &trans                                &trans                                   &trans                                 &trans                                     &trans
/*  -------------------------------------  --------------------------------------| |-------------------------------------| |-------------------------------------| |-------------------------------------|  -------------------------------------                                        -------------------------------------  |-------------------------------------| |-------------------------------------| |-------------------------------------| ├─────────────────────────────────────┼─┼─────────────────────────────────────╯ */
/*                                                                                 │                 ---                 │ │                   ---               │ │                  ---                │                                                                                                                      │                 ---                 │ │                ---                  │ │                   ---               │ */
                                                                                                    &trans                                  &trans                                  &trans                                                                                                                                                        &trans                                &trans                                    &trans
/*                                                                                  -------------------------------------   -------------------------------------   -------------------------------------                                                                                                                        -------------------------------------   -------------------------------------   -------------------------------------  */
/*                                                                                                                         |-------------------------------------| |-------------------------------------| |-------------------------------------|                                      |-------------------------------------| |-------------------------------------| |-------------------------------------| */
/*                                                                                                                         │                ---                  │ │                   ---               │ │                ---                  │                                      │                 ---                 │ │                  ---                │ │                 ---                 │ */
                                                                                                                                            &trans                                  &trans                                 &trans                                                                       &trans                                    &trans                                &trans 
/*                                                                                                                          -------------------------------------   -------------------------------------   -------------------------------------                                        -------------------------------------   -------------------------------------   -------------------------------------  */
            >;
        };
