/* Go60 layer binding - symbol_rh.dtsi
 * Board: Go60 (go60_lh / go60_rh)
 */
/* LAYER 20: Symbol_rh - triggered by right index (H), left hand types symbols */
        LAYER_Symbol_rh {
            bindings = <
/*  -------------------------------------| |-------------------------------------| |-------------------------------------| |-------------------------------------| |-------------------------------------| |-------------------------------------|                                      |-------------------------------------| |-------------------------------------| |-------------------------------------| |-------------------------------------| |-------------------------------------| |-------------------------------------| */
/* │                ---                  │ │                 ---                 │ │                ---                  │ │                 ---                 │ │                ---                  │ │                  ---                │                                      │                  ---                │ │                 ---                 │ │                ---                  │ │                  ---                │ │                 ---                 │ │                 ---                 │ */
                   &trans                                   &trans                                 &trans                                  &trans                                  &trans                                    &trans                                                                       &trans                                 &trans                                  &trans                                  &trans                                  &trans                                  &trans
/* |-------------------------------------| |-------------------------------------| |-------------------------------------| |-------------------------------------| |-------------------------------------| |-------------------------------------|                                      |-------------------------------------| |-------------------------------------| |-------------------------------------| |-------------------------------------| |-------------------------------------| |-------------------------------------| */
/* │                ---                  │ │                  ~                  │ │                 $                   │ │                 #                   │ │                  ^                  │ │                  ---                │                                      │                  ---                │ │                 ---                 │ │                ---                  │ │                  ---                │ │                 ---                 │ │                 ---                 │ */
                   &trans                                  &kp TILDE                              &kp DOLLAR                                &kp HASH                               &kp CARET                                 &trans                                                                       &trans                                 &trans                                  &trans                                  &trans                                  &trans                                  &trans
/* |-------------------------------------| |-------------------------------------| |-------------------------------------| |-------------------------------------| |-------------------------------------| |-------------------------------------|                                      |-------------------------------------| |-------------------------------------| |-------------------------------------| |-------------------------------------| |-------------------------------------| |-------------------------------------| */
/* │             CAPS WORD               │ │                  -                  │ │                  *                  │ │                 |                   │ │                  &                  │ │                  ---                │                                      │                  ---                │ │                 ---                 │ │                ---                  │ │                 ---                 │ │                 ---                 │ │                 ---                 │ */
                 &caps_word                              &kp MINUS                               &kp STAR                                &kp PIPE                                  &kp AMPS                                  &trans                                                                       &kp H                                 &trans                                  &trans                                  &trans                                  &trans                                  &trans
/* |-------------------------------------| |-------------------------------------| |-------------------------------------| |-------------------------------------| |-------------------------------------| |-------------------------------------|                                      |-------------------------------------| |-------------------------------------| |-------------------------------------| |-------------------------------------| |-------------------------------------| |-------------------------------------| */
/* │               MAGIC                 │ │                  {                  │ │                   }                 │ │                 <>                  │ │                 >                   │ │                  ---                │                                      │                  ---                │ │                 ---                 │ │                ---                  │ │                 ---                 │ │                 ---                 │ │                 ---                 │ */
          &magic LAYER_Magic 0                           &pair_brace                              &kp RBRC                               &pair_angle                               &kp GT                                    &trans                                                                       &trans                                 &trans                                  &trans                                  &trans                                  &trans                                  &trans
/*  -------------------------------------  --------------------------------------| |-------------------------------------| |-------------------------------------| |-------------------------------------|  -------------------------------------                                        -------------------------------------  |-------------------------------------| |-------------------------------------| |-------------------------------------| ├─────────────────────────────────────┼─┼─────────────────────────────────────╯ */
/*                                         │                 ---                 │ │                ---                  │ │                 ---                 │                                                                                                                                                              │                ---                  │ │                 ---                 │ │                  ---                │ */
                                                            &trans                                &trans                                   &trans                                                                                                                                                                                                &trans                                  &trans                                  &trans
/*                                          -------------------------------------   -------------------------------------   -------------------------------------                                                                                                                                                                -------------------------------------   -------------------------------------   -------------------------------------  */
/*                                                                                                                         |-------------------------------------| |-------------------------------------| |-------------------------------------|                                      |-------------------------------------| |-------------------------------------| |-------------------------------------| */
/*                                                                                                                         │               TO BASE               │ │                  ---                │ │                  ---                │                                      │                  ---                │ │                 ---                 │ │                  ---                │ */
                                                                                                                                       &to LAYER_Base                               &trans                                   &trans                                                                      &trans                                  &trans                                  &trans
/*                                                                                                                          -------------------------------------   -------------------------------------   -------------------------------------                                        -------------------------------------   -------------------------------------   -------------------------------------  */
            >;
        };
