/* Go60 layer binding - cursor.dtsi
 * Board: Go60 (go60_lh / go60_rh)
 */
/* LAYER 11: Cursor / Navigation */
        LAYER_Cursor {
            bindings = <
/*  -------------------------------------  |-------------------------------------| |-------------------------------------| |-------------------------------------| |-------------------------------------| |-------------------------------------|                                      |-------------------------------------| |-------------------------------------| |-------------------------------------| |-------------------------------------| |-------------------------------------| |-------------------------------------| */
/* │                ---                  │ │                   ---               │ │                  ---                │ │                ---                  │ │             RIGHT CLICK             │ │              SCROLL UP              │                                      │              SCROLL UP              │ │                 ---                 │ │                 ---                 │ │                 ---                 │ │                ---                  │ │                  ---                │ */
                 &trans                                     &trans                                   &none                                &trans                                &mkp RCLK                                  &kp LG(PLUS)                                                               &msc SCRL_UP                                 &trans                                &trans                                   &trans                                 &trans                                    &trans
/* |-------------------------------------| |-------------------------------------| |-------------------------------------| |-------------------------------------| |-------------------------------------| |-------------------------------------|                                      |-------------------------------------| |-------------------------------------| |-------------------------------------| |-------------------------------------| |-------------------------------------| |-------------------------------------| */
/* │                ---                  │ │                  ---                │ │                 ---                 │ │               MOUSE UP              │ │              LEFT CLICK             │ │              SCROLL DOWN            │                                      │                 ---                 │ │                 ---                 │ │              MOVE UP                │ │                 ---                 │ │                ---                  │ │                  ---                │ */
                 &trans                                     &trans                                   &none                               &mmv MOVE_UP                             &mkp LCLK                                &kp LG(MINUS)                                                            &msc SCRL_DOWN                               &trans                               &mmv MOVE_UP                               &trans                                  &trans                                    &trans
/* |-------------------------------------| |-------------------------------------| |-------------------------------------| |-------------------------------------| |-------------------------------------| |-------------------------------------|                                      |-------------------------------------| |-------------------------------------| |-------------------------------------| |-------------------------------------| |-------------------------------------| |-------------------------------------| */
/* │                ---                  │ │                  ---                │ │              MOUSE LEFT             │ │               MOUSE DOWN            │ │              MOUSE RIGHT            │ │                ---                  │                                      │                 ---                 │ │               MOVE LEFT             │ │              MOVE DOWN              │ │              MOVE RIGHT             │ │                ---                  │ │                   ---               │ */
                 &trans                                     &none                               &mmv MOVE_LEFT                           &mmv MOVE_DOWN                        &mmv MOVE_RIGHT                              &none                                                                        &trans                              &mmv MOVE_LEFT                          &mmv MOVE_DOWN                          &mmv MOVE_RIGHT                             &trans                                     &trans
/* |-------------------------------------| |-------------------------------------| |-------------------------------------| ├───────────────────── ───────────────┤ |-------------------------------------| |-------------------------------------|                                      |-------------------------------------| |-------------------------------------| |-------------------------------------| |-------------------------------------| |-------------------------------------| |-------------------------------------| */
/* │               ---                   │ │                 ---                 │ │                 ---                 │ │               MOUSEFAST             │ │              MOUSEWARP              │ │              MOUSESLOW              │                                      │              MOUSESLOW              │ │               MOUSEFAST             │ │             MOUSEWARP               │ │                 ---                 │ │                ---                  │ │                   ---               │ */
                 &none                                      &none                                   &none                             &mo LAYER_MouseFast                     &mo LAYER_MouseWarp                     &mo LAYER_MouseSlow                                                         &mo LAYER_MouseSlow                     &mo LAYER_MouseFast                     &mo LAYER_MouseWarp                            &none                                   &trans                                     &trans
/*  -------------------------------------  --------------------------------------| |-------------------------------------| |-------------------------------------| |-------------------------------------|  -------------------------------------                                        -------------------------------------  |-------------------------------------| |-------------------------------------| |-------------------------------------| ├─────────────────────────────────────┼─┼─────────────────────────────────────╯ */
/*                                         │                LCTRL                │ │                 ---                 │ │                 ---                 │                                                                                                                                                              │                 ---                 │ │                ---                  │ │                 ---                 │ */
                                                            &trans                                  &trans                                  &trans                                                                                                                                                                                               &trans                                 &trans                                   &trans
/*                                          -------------------------------------   -------------------------------------   -------------------------------------                                                                                                                                                                -------------------------------------   -------------------------------------   -------------------------------------  */
/*                                                                                                                         |-------------------------------------| |-------------------------------------| |-------------------------------------|                                      |-------------------------------------| |-------------------------------------| |-------------------------------------| */
/*                                                                                                                         │                DEL                  │ │           RIGHT CLICK               │ │             LEFT MOUSE              │                                      │            LEFT MOUSE               │ │           RIGHT MOUSE               │ │                 ---                 │ */
                                                                                                                                          &kp DEL                                &mkp RCLK                                 &mkp LCLK                                                                  &mkp LCLK                                &mkp RCLK                                  &trans 
/*                                                                                                                          -------------------------------------   -------------------------------------   -------------------------------------                                        -------------------------------------   -------------------------------------   -------------------------------------  */
            >;
        };
