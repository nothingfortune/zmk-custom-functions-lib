/* Go60 layer binding - keypad.dtsi
 * Board: Go60 (go60_lh / go60_rh)
 */
/* LAYER 12: Keypad / Numpad */
        LAYER_Keypad {
            bindings = <
/*  -------------------------------------  |-------------------------------------| |-------------------------------------| |-------------------------------------| |-------------------------------------| |-------------------------------------|                                      |-------------------------------------| |-------------------------------------| |-------------------------------------| |-------------------------------------| |-------------------------------------| |-------------------------------------| */
/* │                F1                   │ │                   F2                │ │                   F3                │ │                 F4                  │ │                  F5                 │ │                  F6                 │                                      │                   F7                │ │                  F8                 │ │                  F9                 │ │                 F10                 │ │                 F11                 │ │                 F12                 │ */
                  &kp F1                                     &kp F2                                  &kp F3                                 &kp F4                                   &kp F5                                 &kp F6                                                                        &kp F7                                 &kp F8                                   &kp F9                                &kp F10                                 &kp F11                                 &kp F12
/* |-------------------------------------| |-------------------------------------| |-------------------------------------| |-------------------------------------| |-------------------------------------| |-------------------------------------|                                      |-------------------------------------| |-------------------------------------| |-------------------------------------| |-------------------------------------| |-------------------------------------| |-------------------------------------| */
/* │                TAB                  │ │                    /                │ │                   7                 │ │                   8                 │ │                   9                 │ │                 STAR                │                                      │                   /                 │ │                   7                 │ │                  8                  │ │                  9                  │ │                 STAR                │ │                 ---                 │ */
                  &kp TAB                                  &kp SLASH                                 &kp N7                                  &kp N8                                  &kp N9                                 &kp STAR                                                                     &kp SLASH                               &kp N7                                   &kp N8                                &kp N9                                  &kp STAR                                 &trans
/* |-------------------------------------| |-------------------------------------| |-------------------------------------| |-------------------------------------| |-------------------------------------| |-------------------------------------|                                      |-------------------------------------| |-------------------------------------| |-------------------------------------| |-------------------------------------| |-------------------------------------| |-------------------------------------| */
/* │                ---                  │ │                    -                │ │                   4                 │ │                   5                 │ │                   6                 │ │                   +                 │                                      │                   -                 │ │                   4                 │ │                  5                  │ │                  6                  │ │                   +                 │ │                 ---                 │ */
                   &none                                    &kp MINUS                               &kp N4                                   &kp N5                                  &kp N6                                 &kp PLUS                                                                     &kp MINUS                               &kp N4                                   &kp N5                                &kp N6                                  &kp PLUS                                 &trans
/* |-------------------------------------| |-------------------------------------| |-------------------------------------| |-------------------------------------| |-------------------------------------| |-------------------------------------|                                      |-------------------------------------| |-------------------------------------| |-------------------------------------| |-------------------------------------| |-------------------------------------| |-------------------------------------| */
/* │               MAGIC                 │ │                  ---                │ │                   1                 │ │                   2                 │ │                   3                 │ │                 B                   │                                      │                  ---                │ │                   1                 │ │                  2                  │ │                   3                 │ │                  /                  │ │                 NUMPAD              │ */
          &magic LAYER_Magic 0                                &none                                 &kp N1                                  &kp N2                                  &kp N3                                 &kp B                                                                         &none                                  &kp N1                                   &kp N2                                &kp N3                                  &kp EQUAL                               &numpad_td
/*  -------------------------------------  --------------------------------------| |-------------------------------------| |-------------------------------------| |-------------------------------------|  -------------------------------------                                        -------------------------------------  |-------------------------------------| |-------------------------------------| |-------------------------------------| ├─────────────────────────────────────┼─┼─────────────────────────────────────╯ */
/*                                                                                 │                 ---                 │ │                   .                 │ │                   0                 │                                                                                                                      │                  .                  │ │                 N0                  │ │                TO BASE              │ */
                                                                                                    &trans                                &kp DOT                                   &kp N0                                                                                                                                                       &kp N0                                 &kp DOT                               &to LAYER_Base
/*                                                                                  -------------------------------------   -------------------------------------   -------------------------------------                                                                                                                        -------------------------------------   -------------------------------------   -------------------------------------  */
/*                                                                                                                         |-------------------------------------| |-------------------------------------| |-------------------------------------|                                      |-------------------------------------| |-------------------------------------| |-------------------------------------| */
/*                                                                                                                         │           NAV(hold)/SPACE           │ │                ---                  │ │                 ---                 │                                      │                  ---                │ │                 ---                 │ │                  ---                │ */
                                                                                                                                      &mo LAYER_Symbol                             &trans                                   &trans                                                                        &trans                                  &trans                                  &trans
/*                                                                                                                          -------------------------------------   -------------------------------------   -------------------------------------                                        -------------------------------------   -------------------------------------   -------------------------------------  */
            >;
        };
