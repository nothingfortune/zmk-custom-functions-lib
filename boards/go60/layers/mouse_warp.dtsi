/* Go60 layer binding - mouse_warp.dtsi
 * Board: Go60 (go60_lh / go60_rh)
 */
/* LAYER 17: Mouse Warp */
        LAYER_MouseWarp {
            bindings = <
/*  -------------------------------------| |-------------------------------------| |-------------------------------------| |-------------------------------------| |-------------------------------------| |-------------------------------------|                                      |-------------------------------------| |-------------------------------------| |-------------------------------------| |-------------------------------------| |-------------------------------------| |-------------------------------------| */
/* │                ---                  │ │                   ---               │ │                  ---                │ │                 ---                 │ │                  ---                │ │                  ---                │                                      │                 ---                 │ │                  ---                │ │                 ---                 │ │                 ---                 │ │                ---                  │ │                  ---                │ */
                 &trans                                     &trans                                  &trans                                  &trans                                  &trans                                 &trans                                                                       &trans                                    &trans                                &trans                                    &trans                                 &trans                                     &trans
/* |-------------------------------------| |-------------------------------------| |-------------------------------------| |-------------------------------------| |-------------------------------------| |-------------------------------------|                                      |-------------------------------------| |-------------------------------------| |-------------------------------------| |-------------------------------------| |-------------------------------------| |-------------------------------------| */
/* │                ---                  │ │                   ---               │ │                  ---                │ │                 ---                 │ │                  ---                │ │                 ---                 │                                      │                 ---                 │ │                  ---                │ │                 ---                 │ │                  ---                │ │                ---                  │ │                  ---                │ */
                 &trans                                     &trans                                  &trans                                   &trans                                  &trans                                 &trans                                                                        &trans                                  &trans                                &trans                                  &trans                                 &trans                                     &trans
/* |-------------------------------------| |-------------------------------------| |-------------------------------------| |-------------------------------------| |-------------------------------------| |-------------------------------------|                                      |-------------------------------------| |-------------------------------------| |-------------------------------------| |-------------------------------------| |-------------------------------------| |-------------------------------------| */
/* │                ---                  │ │                  ---                │ │                  ---                │ │                 ---                 │ │                  ---                │ │                ---                  │                                      │                 ---                 │ │                  ---                │ │                 ---                 │ │                 ---                 │ │                ---                  │ │                   ---               │ */
                 &trans                                     &trans                                  &trans                                  &trans                                  &trans                                 &trans                                                                        &trans                                   &trans                                &trans                                   &trans                                 &trans                                     &trans
/* |-------------------------------------| |-------------------------------------| |-------------------------------------| ├───────────────────── ───────────────┤ |-------------------------------------| |-------------------------------------|                                      |-------------------------------------| |-------------------------------------| |-------------------------------------| |-------------------------------------| |-------------------------------------| |-------------------------------------| */
/* │               MAGIC                 │ │                  ---                │ │                 ---                 │ │                 ---                 │ │                  ---                │ │                 ---                 │                                      │                 ---                 │ │                  ---                │ │                 ---                 │ │                 ---                 │ │                ---                  │ │                   ---               │ */
          &magic LAYER_Magic 0                              &trans                                  &trans                                  &trans                                  &trans                                 &trans                                                                        &trans                                   &trans                                &trans                                   &trans                                 &trans                                     &trans
/*  -------------------------------------  --------------------------------------| |-------------------------------------| |-------------------------------------| |-------------------------------------|  -------------------------------------                                        -------------------------------------  |-------------------------------------| |-------------------------------------| |-------------------------------------| ├─────────────────────────────────────┼─┼─────────────────────────────────────╯ */
/*                                                                                 │                 ---                 │ │                   ---               │ │                 ---                 │                                                                                                                     │                  ---                 │ │                ---                  │ │                   ---               │ */
                                                                                                    &trans                                  &trans                                  &trans                                                                                                                                                        &trans                                &trans                                    &trans
/*                                                                                  -------------------------------------   -------------------------------------   -------------------------------------                                                                                                                        -------------------------------------   -------------------------------------   -------------------------------------  */
/*                                                                                                                         |-------------------------------------| |-------------------------------------| |-------------------------------------|                                      |-------------------------------------| |-------------------------------------| |-------------------------------------| */
/*                                                                                                                         │                ---                  │ │                   ---               │ │                ---                  │                                      │                 ---                 │ │                  ---                │ │                 ---                 │ */
                                                                                                                                            &trans                                  &trans                                 &trans                                                                       &trans                                    &trans                                &trans 
/*                                                                                                                          -------------------------------------   -------------------------------------   -------------------------------------                                        -------------------------------------   -------------------------------------   -------------------------------------  */
            >;
        };
