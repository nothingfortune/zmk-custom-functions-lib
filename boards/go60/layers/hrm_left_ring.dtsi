/* Go60 layer binding - hrm_left_ring.dtsi
 * Board: Go60 (go60_lh / go60_rh)
 */
/* LAYER 4: LeftRingy HRM - ALT hold */
        LAYER_LeftRingy {
            bindings = <
/* --------------------------------------| |-------------------------------------| |-------------------------------------| |-------------------------------------| |-------------------------------------| |-------------------------------------|                                      |-------------------------------------| |-------------------------------------| |-------------------------------------| |-------------------------------------| |-------------------------------------| |-------------------------------------| */
/* │                Esc                  │ │                   1                 │ │                  2                  │ │                 3                   │ │                  4                  │ │                 5                   │                                      │                  6                  │ │                  7                  │ │                  8                  │ │                  9                  │ │                  0                  │ │                  {}                 │ */
      &HRM_left_ring_tap_v1B_TKZ EQUAL                      &trans                                &trans                                  &trans                                    &trans                                 &trans                                                                      &trans                                   &trans                                  &trans                                  &trans                                  &trans                                   &trans
/* |-------------------------------------| |-------------------------------------| |-------------------------------------| |-------------------------------------| |-------------------------------------| |-------------------------------------|                                      |-------------------------------------| |-------------------------------------| |-------------------------------------| |-------------------------------------| |-------------------------------------| |-------------------------------------| */
/* │                ---                  │ │                   Q                 │ │                  W                  │ │                 E                   │ │                  R                  │ │                 T                   │                                      │                  Y                  │ │                  U                  │ │                  I                  │ │                  O                  │ │                  P                  │ │                  \|                 │ */
                  &trans                        &HRM_left_ring_tap_v1B_TKZ Q             &HRM_left_ring_tap_v1B_TKZ W          &HRM_left_ring_tap_v1B_TKZ E             &HRM_left_ring_tap_v1B_TKZ R            &HRM_left_ring_tap_v1B_TKZ T                                                           &trans                                   &trans                                  &trans                                  &trans                                  &trans                                   &trans
/* |-------------------------------------| |-------------------------------------| |-------------------------------------| |-------------------------------------| |-------------------------------------| |-------------------------------------|                                      |-------------------------------------| |-------------------------------------| |-------------------------------------| |-------------------------------------| |-------------------------------------| |-------------------------------------| */
/* │               CAPS                  │ │                   A                 │ │                  S                  │ │                 D                   │ │                  F                  │ │                 G                   │                                      │                 H                   │ │                  J                  │ │                  K                  │ │                 L                   │ │                SEMI                 │ │                QUOTE                │ */
                  &trans                    &HRM_left_ring_pinky_v1B_TKZ LGUI A                    &none                     &HRM_left_ring_middy_v1B_TKZ LCTRL D    &HRM_left_ring_index_v1B_TKZ LSHFT F       &HRM_left_ring_tap_v1B_TKZ G                                                           &trans                                   &kp J                                   &kp K                                   &kp K                                   &kp SEMI                                 &trans
/* |-------------------------------------| |-------------------------------------| |-------------------------------------| ├───────────────────── ───────────────┤ |-------------------------------------| |-------------------------------------|                                      |-------------------------------------| |-------------------------------------| |-------------------------------------| |-------------------------------------| |-------------------------------------| |-------------------------------------| */
/* │               MAGIC                 │ │                   Z                 │ │                 X                   │ │                 C                   │ │                  V                  │ │                 B                   │                                      │                 N                   │ │                  M                  │ │               COMMA                 │ │                DOT                  │ │               QMARK                 │ │                 LSHFT               │ */
                  &trans                        &HRM_left_ring_tap_v1B_TKZ Z           &HRM_left_ring_tap_v1B_TKZ X           &HRM_left_ring_tap_v1B_TKZ C             &HRM_left_ring_tap_v1B_TKZ V             &HRM_left_ring_tap_v1B_TKZ B                                                           &trans                                   &trans                                  &trans                                  &trans                                  &trans                                   &trans
/*  -------------------------------------  --------------------------------------| |-------------------------------------| |-------------------------------------| |-------------------------------------|  -------------------------------------                                        -------------------------------------  |-------------------------------------| |-------------------------------------| |-------------------------------------| ├─────────────────────────────────────┼─┼─────────────────────────────────────╯ */
/*                                                                                 │                 LCTRL               │ │                 ---                 │ │                ---                  │                                                                                                                                                              │                ---                  │ │                ---                  │ │                  ---                │ */
                                                                                                    &trans                                  &trans                                 &trans                                                                                                                                                                                               &trans                                  &trans                                   &trans
/*                                                                                  -------------------------------------   -------------------------------------   -------------------------------------                                                                                                                                                                -------------------------------------   -------------------------------------   -------------------------------------  */
/*                                                                                                                         |-------------------------------------| |-------------------------------------| |-------------------------------------|                                      |-------------------------------------| |-------------------------------------| |-------------------------------------| */
/*                                                                                                                         │                ---                  │ │                   ---               │ │                ---                  │                                      │                 ---                 │ │                  ---                │ │                 ---                 │ */
                                                                                                                                          &trans                                    &trans                                 &trans                                                                       &trans                                    &trans                                &trans 
/*                                                                                                                          -------------------------------------   -------------------------------------   -------------------------------------                                        -------------------------------------   -------------------------------------   -------------------------------------  */
            >;
        };
