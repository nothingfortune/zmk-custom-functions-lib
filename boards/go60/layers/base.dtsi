/* Go60 layer binding - base.dtsi
 * Board: Go60 (go60_lh / go60_rh)
 */
/* LAYER 0: Base - QWERTY with Home Row Mods */
        LAYER_Base {
            bindings = <
/* --------------------------------------| |-------------------------------------| |-------------------------------------| |-------------------------------------| |-------------------------------------| |-------------------------------------|                                      |-------------------------------------| |-------------------------------------| |-------------------------------------| |-------------------------------------| |-------------------------------------| |-------------------------------------| */
/* │               ESC/`                 │ │                   1/!               │ │                   2/@               │ │                 3/#                 │ │                  4/$                │ │                  5/%                │                                      │                  6/^                │ │                   7/&               │ │                  8/*                │ │                   9/()              │ │                 0/)                 │ │                   {}                │ */
                 &gresc                             &num_ht LS(N1) N1                        &num_ht LS(N2) N2                      &num_ht LS(N3) N3                       &num_ht LS(N4) N4                         &num_ht LS(N5) N5                                                            &num_ht LS(N6) N6                      &num_ht LS(N7) N7                         &num_ht LS(N8) N8                           &n9_paren                           &num_ht LS(N0) N0                          &pair_brace
/* |-------------------------------------| |-------------------------------------| |-------------------------------------| |-------------------------------------| |-------------------------------------| |-------------------------------------|                                      |-------------------------------------| |-------------------------------------| |-------------------------------------| |-------------------------------------| |-------------------------------------| |-------------------------------------| */
/* │                TAB                  │ │                    Q                │ │                   W                 │ │                   E                 │ │                   R                 │ │                 T                   │                                      │                   Y                 │ │                   U                 │ │                  I                  │ │                  O                  │ │                  P                  │ │                   ()                │ */
        &tab_hyper LS(LC(LA(LGUI))) TAB                       &kp Q                                  &kp W                                  &kp E                                   &kp R                                 &kp T                                                                          &kp Y                                   &kp U                                   &kp I                                   &kp O                                  &kp P                                  &pair_paren
/* |-------------------------------------| |-------------------------------------| |-------------------------------------| |-------------------------------------| |-------------------------------------| |-------------------------------------|                                      |-------------------------------------| |-------------------------------------| |-------------------------------------| |-------------------------------------| |-------------------------------------| |-------------------------------------| */
/* │              CAPS WORD              │ │            GUI(hold)/A              │ │             ALT(hold)/S             │ │             CTRL(hold)/D            │ │            SHIFT(hold)/F            │ │            SYMB(hold)/G             │                                      │             SYMB(hold)/H            │ │             SHIFT(hold)/J           │ │               CTRL(hold)/K          │ │              ALT(hold)/L            │ │            GUI(hold)/;              │ │                   ""                │ */
               &lshft_cw_td                     &HRM_left_pinky_v1B_TKZ LGUI A          &HRM_left_ring_v1B_TKZ LALT S          &HRM_left_middy_v1B_TKZ LCTRL D         &HRM_left_index_v1B_TKZ LSHFT F               &SYM_left_index_v1B_TKZ LAYER_Symbol_lh G                         &SYM_right_index_v1B_TKZ LAYER_Symbol_rh H  &HRM_right_index_v1B_TKZ RSHFT J        &HRM_right_middy_v1B_TKZ RCTRL K         &HRM_right_ring_v1B_TKZ LALT L         &HRM_right_pinky_v1B_TKZ RGUI SEMI                  &dqt_pair
/* |-------------------------------------| |-------------------------------------| |-------------------------------------| |-------------------------------------| |-------------------------------------| |-------------------------------------|                                      |-------------------------------------| |-------------------------------------| |-------------------------------------| |-------------------------------------| |-------------------------------------| |-------------------------------------| */
/* │               MAGIC                 │ │                    Z                │ │                    X                │ │                  C                  │ │                   V                 │ │                 B                   │                                      │                   N                 │ │                   M                 │ │                 ,/<>                │ │                   .                 │ │                  /                  │ │                 NUMPAD              │ */
          &magic LAYER_Magic 0                                &kp Z                                   &kp X                                 &kp C                                    &kp V                                 &kp B                                                                          &kp N                                  &kp M                                &comma_angle                               &kp DOT                               &kp FSLH                                 &numpad_td
/*  -------------------------------------  --------------------------------------| |-------------------------------------| |-------------------------------------| |-------------------------------------|  -------------------------------------                                        -------------------------------------  |-------------------------------------| |-------------------------------------| |-------------------------------------| ├─────────────────────────────────────┼─┼─────────────────────────────────────╯ */
/*                                                                                 │                  LCTRL              │ │                 LALT  nn            │ │                 CMD                 │                                                                                                                      │            LEFT/WORD-LEFT           │ │                DOWN                 │ │            RIGHT/WORD-RIGHT         │ */
                                                                                                   &kp LCTRL                                &kp LALT                              &kp LGUI                                                                                                                                              &arrow_left LA(LEFT) LEFT                   &upDownArrows                     &arrow_right LA(RIGHT) RIGHT
/*                                                                                  -------------------------------------   -------------------------------------   -------------------------------------                                                                                                                        -------------------------------------   -------------------------------------   -------------------------------------  */
/*                                                                                                                         |-------------------------------------| |-------------------------------------| |-------------------------------------|                                      |-------------------------------------| |-------------------------------------| |-------------------------------------| */
/*                                                                                                                         │           NAV(hold)/SPACE           │ │                ENTER                │ │             NUMPAD(hold)/?          │                                      │              SYMB(hold)/.           │ │             BSPC/DEL-WORD           │ │          NAV(hold)/SPACE            │ */
                                                                                                                               &thumb_v2_TKZ LAYER_Cursor SPACE        &thumb_v2_TKZ LAYER_Keypad RET              &thumb_v2_TKZ DEL QMARK                                                      &thumb_v2_TKZ DEL PERIOD               &bspc_word LA(BSPC) BSPC           &thumb_v2_TKZ LAYER_Keypad SPACE
/*                                                                                                                          -------------------------------------   -------------------------------------   -------------------------------------                                        -------------------------------------   -------------------------------------   -------------------------------------  */
            >;
        };
