/* Go60 layer binding - mouse.dtsi
 * Board: Go60 (go60_lh / go60_rh)
 */
/* LAYER 14: Mouse */
        LAYER_Mouse {
            bindings = <
/*  -------------------------------------| |-------------------------------------| |-------------------------------------| |-------------------------------------| |-------------------------------------| |-------------------------------------|                                      |-------------------------------------| |-------------------------------------| |-------------------------------------| |-------------------------------------| |-------------------------------------| |-------------------------------------| */
/* │               ESC                   │ │           Mission Control           │ │              SCROLL UP              │ │                ---                  │ │            RIGHT CLOCK              │ │                ZOOM OUT             │                                      │                 ---                 │ │                  ---                │ │                 ---                 │ │                 ---                 │ │             Mission Control         │ │               App Exposè            │ */
                &kp ESC                               &mac_mission_ctl                           &msc SCRL_UP                               &trans                                &mkp RCLK                              &kp LG(MINUS)                                                                  &trans                                   &trans                                &trans                                    &trans                             &mac_mission_ctl                         &mac_app_expose
/* |-------------------------------------| |-------------------------------------| |-------------------------------------| |-------------------------------------| |-------------------------------------| |-------------------------------------|                                      |-------------------------------------| |-------------------------------------| |-------------------------------------| |-------------------------------------| |-------------------------------------| |-------------------------------------| */
/* │              Expose                 │ │                  ---                │ │             SCROLL DOWN             │ │               MOUSE UP              │ │              LEFT CLICK             │ │                 ZOOM IN             │                                      │                 ---                 │ │                  ---                │ │               MOVE UP               │ │                  ---                │ │                ---                  │ │                  ---                │ */
            &mac_app_expose                                 &trans                              &msc SCRL_DOWN                           &mmv MOVE_UP                             &mkp LCLK                              &kp LG(PLUS)                                                                   &trans                                   &trans                              &mmv MOVE_UP                                &trans                                 &trans                                     &trans
/* |-------------------------------------| |-------------------------------------| |-------------------------------------| |-------------------------------------| |-------------------------------------| |-------------------------------------|                                      |-------------------------------------| |-------------------------------------| |-------------------------------------| |-------------------------------------| |-------------------------------------| |-------------------------------------| */
/* │                ---                  │ │              SCROLL LEFT            │ │              MOUSE LEFT             │ │               MOUSE DOWN            │ │              MOUNT RIGHT            │ │            SCROLL RIGHT             │                                      │                 ---                 │ │                MOVE LEFT            │ │               MOVE DOWN             │ │               MOVE RIGHT            │ │                ---                  │ │                   ---               │ */
                 &trans                                 &msc SCRL_LEFT                          &mmv MOVE_LEFT                           &mmv MOVE_DOWN                        &mmv MOVE_RIGHT                          &msc SCRL_RIGHT                                                                 &trans                               &mmv MOVE_LEFT                       &mmv MOVE_DOWN                            &mmv MOVE_RIGHT                             &trans                                     &trans
/* |-------------------------------------| |-------------------------------------| |-------------------------------------| ├───────────────────── ───────────────┤ |-------------------------------------| |-------------------------------------|                                      |-------------------------------------| |-------------------------------------| |-------------------------------------| |-------------------------------------| |-------------------------------------| |-------------------------------------| */
/* │               ---                   │ │             SCROLL DOWN             │ │              MOUSESLOW              │ │               MOUSEFAST             │ │              MOUSEWARP              │ │                 DEL                 │                                      │                 ---                 │ │               MOUSEWARP             │ │             MOUSEFAST               │ │               MOUSESLOW             │ │                ---                  │ │                   ---               │ */
                 &none                                  &msc SCRL_DOWN                      &mo LAYER_MouseSlow                      &mo LAYER_MouseFast                     &mo LAYER_MouseWarp                           &kp DEL                                                                      &trans                            &mo LAYER_MouseWarp                     &mo LAYER_MouseFast                    &mo LAYER_MouseSlow                            &trans                                     &trans
/*  -------------------------------------  --------------------------------------| |-------------------------------------| |-------------------------------------| |-------------------------------------|  -------------------------------------                                        -------------------------------------  |-------------------------------------| |-------------------------------------| |-------------------------------------| ├─────────────────────────────────────┼─┼─────────────────────────────────────╯ */
/*                                         │                 ---                 │ │                 ---                 │ │                 ---                 │                                                                                                                                                              │                 ---                 │ │                ---                  │ │                   ---               │ */
                                                            &trans                                  &trans                                  &trans                                                                                                                                                                                               &trans                                 &trans                                     &trans
/*                                          -------------------------------------   -------------------------------------   -------------------------------------                                                                                                                                                                -------------------------------------   -------------------------------------   -------------------------------------  */
/*                                                                                                                         |-------------------------------------| |-------------------------------------| |-------------------------------------|                                      |-------------------------------------| |-------------------------------------| |-------------------------------------| */
/*                                                                                                                         │                DEL                  │ │                ---                  │ │                 ---                 │                                      │            LEFT MOUSE               │ │                 ---                 │ │                 ---                 │ */
                                                                                                                                          &kp DEL                                  &trans                                   &trans                                                                    &mkp LCLK                                  &trans                                  &trans 
/*                                                                                                                          -------------------------------------   -------------------------------------   -------------------------------------                                        -------------------------------------   -------------------------------------   -------------------------------------  */
            >;
        };
