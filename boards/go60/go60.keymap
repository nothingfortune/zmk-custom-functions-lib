/*
 * Copyright (c) 2020 The ZMK Contributors
 * Copyright (c) 2025 Innaworks Development Limited, trading as MoErgo
 *
 * SPDX-License-Identifier: MIT
 */

/* ── ZMK core includes ─────────────────────────────── */
#include <behaviors.dtsi>
#include <dt-bindings/zmk/outputs.h>
#include <dt-bindings/zmk/keys.h>
#include <dt-bindings/zmk/bt.h>
#include <dt-bindings/zmk/rgb.h>
#include <input/processors.dtsi>
#include <dt-bindings/zmk/input_transform.h>
#include <zephyr/dt-bindings/input/input-event-codes.h>
#include <dt-bindings/zmk/pointing.h>

/* ── ZMK helper macros ─────────────────────────────── */
#define ZMK_HELPER_STRINGIFY(x) #x
#define VARGS_(_10, _9, _8, _7, _6, _5, _4, _3, _2, _1, N, ...) N
#define VARGS(...) VARGS_(__VA_ARGS__, 10, 9, 8, 7, 6, 5, 4, 3, 2, 1, 0)
#define CONCAT_(a, b) a##b
#define CONCAT(a, b) CONCAT_(a, b)
#define ZMK_BEHAVIOR_CORE_tap_dance  \
    compatible = "zmk,behavior-tap-dance"; \
    #binding-cells = <0>
#define ZMK_BEHAVIOR(name, type, ...) \
    name: name { \
        ZMK_BEHAVIOR_CORE_ ## type; \
        __VA_ARGS__ \
    };
#define ZMK_TAP_DANCE(name, ...) \
    ZMK_BEHAVIOR(name, tap_dance, __VA_ARGS__)
#define ZMK_TD_LAYER(name, layer) \
    ZMK_TAP_DANCE(name, \
        tapping-term-ms = <TD_TAPPING_TERM>; \
        bindings = <&mo layer>, <&to layer>; \
)

/* ── Board-specific ────────────────────────────────── */
#include "positions.dtsi"
#include "position_groups.dtsi"

/* ── Shared library ────────────────────────────────── */
#include "../../shared/layers.dtsi"
#include "../../shared/global_timings.dtsi"

/* ── Board-specific (requires LAYER_* and timing macros) ── */
#include "board_meta.dtsi"

/* ── Shared behaviors & macros ─────────────────────── */
/ {
    behaviors {
        #include "../../shared/macros.dtsi"
        #include "../../shared/homeRowMods/hrm_macros.dtsi"
        #include "../../shared/behaviors.dtsi"
        #include "../../shared/modMorphs.dtsi"
        #include "../../shared/autoshift.dtsi"
        #include "../../shared/bluetooth.dtsi"
        #include "../../shared/magic.dtsi"
        #include "../../shared/homeRowMods/hrm_behaviors.dtsi"
    };
};

/* ── Combos ─────────────────────────────────────────── */
/ {
    combos {
        compatible = "zmk,combos";
        #include "../../shared/combos/combos_common.dtsi"
        #include "../../shared/combos/combos_fkeys.dtsi"
    };
};

/* ── Keymap layers ─────────────────────────────────── */
/ {
    keymap {
        compatible = "zmk,keymap";

        #include "layers/base.dtsi"
        #include "layers/typing.dtsi"
        #include "layers/autoshift.dtsi"
        #include "layers/hrm_left_pinky.dtsi"
        #include "layers/hrm_left_ring.dtsi"
        #include "layers/hrm_left_middy.dtsi"
        #include "layers/hrm_left_index.dtsi"
        #include "layers/hrm_right_pinky.dtsi"
        #include "layers/hrm_right_ring.dtsi"
        #include "layers/hrm_right_middy.dtsi"
        #include "layers/hrm_right_index.dtsi"
        #include "layers/cursor.dtsi"
        #include "layers/keypad.dtsi"
        #include "layers/symbol.dtsi"
        #include "layers/mouse.dtsi"
        #include "layers/mouse_slow.dtsi"
        #include "layers/mouse_fast.dtsi"
        #include "layers/mouse_warp.dtsi"
        #include "layers/magic.dtsi"
        #include "layers/symbol_lh.dtsi"
        #include "layers/symbol_rh.dtsi"
    };
};
