magic: magic {
    compatible = "zmk,behavior-hold-tap";
    label = "MAGIC_HOLD_TAP";
    #binding-cells = <2>;
    flavor = "tap-preferred";
    tapping-term-ms = <TD_TAPPING_TERM>;
    bindings = <&mo>, <&rgb_ug_status_macro>;
};